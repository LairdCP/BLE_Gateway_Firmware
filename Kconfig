## app/Kconfig.single_peripheral
```kconfig
# Copyright (c) 2021 Laird Connectivity
# SPDX-License-Identifier: Apache-2.0

menuconfig SINGLE_PERIPHERAL
    bool "Enable single peripheral (one connection at a time) module"
    help
        Handles advertising
        Prints connection information

if SINGLE_PERIPHERAL

config SINGLE_PERIPHERAL_INIT_PRIORITY
    int "Priority of module init (Application)"
    range 1 99
    default 1
    help
        Must be initialized after Bluetooth is enabled

config SINGLE_PERIPHERAL_LOG_LEVEL
    int "Log level for single peripheral module"
    range 0 4
    default 3

config SINGLE_PERIPHERAL_ADV_ON_INIT
    bool "Start advertising after initialization"
    help
        Advertising after reset is used by the mobile application when updating firmware.

config SINGLE_PERIPHERAL_ADV_DURATION_SECONDS
    int "Seconds to advertise, 0 is indefinite"
    default 30
    help
        This value is also used to restart advertising after a disconnect.

endif # SINGLE_PERIPHERAL
```

## app/Kconfig.wdt
```kconfig
# Copyright (c) 2021 Laird Connectivity
# SPDX-License-Identifier: Apache-2.0

menuconfig WDT
    bool "Config Watchdog Timer"
    imply WATCHDOG
    help
        Enable-to-Disable requires power cycle or watchdog reset.
        Watchdog cannot be stopped once started.
        It can be reconfigured after a reset.
        If a watchdog reset occurs, then it won't cause another reset unless
        it is re-enabled.

if WDT

config WDT_INIT_PRIORITY
    int "System init priority (Application)"
    default 0

config WDT_LOG_LEVEL
    int "Log level for BLE watchdog module"
    range 0 4
    default 3

config WDT_TIMEOUT_MILLISECONDS
    int "Rate in milliseconds for watchdog"
    range 10000 1200000
    default 600000
    help
        The bootloader (mcuboot) supplied with the application prior to
        4.0.0 doesn't feed the watchdog. If the bootloader hasn't been
        updated (requires a physical connection), the timeout should
        remain at 10 minutes.

config WDT_WORK_QUEUE_STACK_SIZE
    int
    default 320

config WDT_WORK_QUEUE_THREAD_PRIORITY
    int "Priority of work queue"
    default 10
    help
        When check-in functions are not used, the priority needs to be lower
        than main so that a non-yielding main causes a reset.

config WDT_TEST
    bool "Force the watchdog to timeout (set during initialization)"

endif # WDT
```

## app/attributes/Kconfig.attribute
```kconfig
#
# Copyright (c) 2021 Laird Connectivity
#
# SPDX-License-Identifier: Apache-2.0
#
menuconfig ATTR
    bool "Enable attribute/parameters module"
    depends on FILE_SYSTEM_UTILITIES
    depends on FRAMEWORK
    depends on LCZ_PARAM_FILE

if ATTR

config ATTR_INIT_PRIORITY
    int "Init priority Application for attribute module"
    range 2 99
    default 2
    help
        Can't be higher than LCZ_PARAM_FILE_INIT_PRIORITY.
        Recommended to be higher than main thread init priority.

config ATTR_LOG_LEVEL
    int "Log level for Attributes module"
    range 0 4
    default 3

config ATTR_FILE_NAME
    string "File name for attributes"
    default "attr.txt"

config ATTR_BREAK_ON_LOAD_FAILURE
    bool "Stop loading on first failure"

config ATTR_SHELL
    bool "Enable Attribute Shell"
    depends on SHELL

config ATTR_SHELL_SHOW_ALL_DELAY_MS
    int "Amount of time to delay between each debug log print"
    depends on ATTR_SHELL
    default 10
    help
        This is used to prevent log system overflow.

config ATTR_SHOW_LOG_LEVEL
    int "Log level for attribute value changes"
    range 0 4
    default 3
    help
        Logging for individual attributes is
        controlled by the shell command 'quiet'

config ATTR_SHOW_FMT
    string "Format for the attribute show command index name"
    default "[%03u] %-30s"

config ATTR_FLOAT_FMT
    string "Default format for floats"
    default "%.4e"

config ATTR_FLOAT_MAX_STR_SIZE
    int "Number of characters (and NULL) for floats converted to string"
    default 13
    help
        An example with ATTR_FLOAT_FMT of %0.4e is -2.8171e+000.

config MCUMGR_CMD_SENTRIUS_MGMT
    bool "Enable the Sentrius MCUMGR interface"
    depends on MCUMGR
    select CBOR_FLOATING_POINT
    select CBOR_HALF_FLOAT_TYPE

config MGMT_GROUP_ID_SENTRIUS
	int "MCU manager group id"
	default 65

endif # ATTR
```

## app/bl654_sensor/Kconfig
```kconfig
# Copyright (c) 2021 Laird Connectivity
# SPDX-License-Identifier: Apache-2.0

menuconfig BL654_SENSOR
    bool "BL654 sensor support"

if BL654_SENSOR

config BL654_SENSOR_LOG_LEVEL
    int "Log level for BL654 Sensor module"
    range 0 4
    default 3

config BL654_SENSOR_SEND_TO_AWS_RATE_SECONDS
    int "The period at which to send BL654 Sensor data to AWS"
    default 60
    range 30 3600

endif # BL654_SENSOR
```

## app/boards/mg100.conf
```kconfig
CONFIG_BT_DEVICE_NAME="MG100"

CONFIG_LCZ_NUMBER_OF_LEDS=3

# SDHC and FAT32 Support
CONFIG_DISK_ACCESS=y
CONFIG_DISK_ACCESS_SDHC=y
CONFIG_DISK_ACCESS_SPI_SDHC=y
CONFIG_DISK_SDHC_VOLUME_NAME="SD"
CONFIG_FILE_SYSTEM=y
CONFIG_FAT_FILESYSTEM_ELM=y

CONFIG_SENSOR_SHELL=n
CONFIG_I2C_SHELL=n

CONFIG_LCZ_DRIVER=y
CONFIG_LCZ_ADC_SAMPLE_PERIOD=3
CONFIG_LCZ_ADC_ALWAYS_SAMPLING=y
```

## app/boards/pinnacle_100_dvk.conf
```kconfig
CONFIG_BT_DEVICE_NAME="Pinnacle 100 OOB"
CONFIG_COAP_FOTA_PRODUCT="Pinnacle-100-DVK"

CONFIG_LCZ_POWER=y

# modem settings
CONFIG_MODEM=y
CONFIG_MODEM_HL7800=y
CONFIG_MODEM_HL7800_RAT_M1=y
# Debug log level is required for using AT commands with the shell
CONFIG_MODEM_LOG_LEVEL_DBG=y
CONFIG_MODEM_HL7800_FW_UPDATE=y
CONFIG_MODEM_HL7800_RECV_BUF_CNT=16
CONFIG_NET_PKT_RX_COUNT=8
CONFIG_NET_BUF_RX_COUNT=48
CONFIG_MODEM_HL7800_GPS=y
CONFIG_MODEM_HL7800_POLTE=y
# CONFIG_MODEM_HL7800_BAND_1=n
# CONFIG_MODEM_HL7800_BAND_2=n
# CONFIG_MODEM_HL7800_BAND_3=n
# CONFIG_MODEM_HL7800_BAND_4=n
# CONFIG_MODEM_HL7800_BAND_5=n
# CONFIG_MODEM_HL7800_BAND_8=n
# CONFIG_MODEM_HL7800_BAND_9=n
# CONFIG_MODEM_HL7800_BAND_10=n
# CONFIG_MODEM_HL7800_BAND_12=n
# CONFIG_MODEM_HL7800_BAND_13=n
# CONFIG_MODEM_HL7800_BAND_14=n
# CONFIG_MODEM_HL7800_BAND_17=n
# CONFIG_MODEM_HL7800_BAND_18=n
# CONFIG_MODEM_HL7800_BAND_19=n
# CONFIG_MODEM_HL7800_BAND_20=y
# CONFIG_MODEM_HL7800_BAND_25=n
# CONFIG_MODEM_HL7800_BAND_26=n
# CONFIG_MODEM_HL7800_BAND_27=n
# CONFIG_MODEM_HL7800_BAND_28=n
# CONFIG_MODEM_HL7800_BAND_66=n

# Memfault
CONFIG_LCZ_MEMFAULT=y
CONFIG_LCZ_MEMFAULT_FILE=y
CONFIG_MEMFAULT_NRF_CONNECT_SDK=y
CONFIG_LCZ_MEMFAULT_HTTP_TRANSPORT=y
CONFIG_LCZ_MEMFAULT_MQTT_TRANSPORT=y
CONFIG_MEMFAULT_COREDUMP_MAX_TRACKED_TASKS=32
CONFIG_LCZ_MEMFAULT_METRICS=y
CONFIG_MEMFAULT_LOGGING_ENABLE=y
CONFIG_MEMFAULT_LOGGING_RAM_SIZE=2048
CONFIG_MEMFAULT_RAM_BACKED_COREDUMP_SIZE=16384
CONFIG_MBEDTLS_USER_CONFIG_ENABLE=y
CONFIG_MBEDTLS_USER_CONFIG_FILE="lcz-memfault-mbedtls.conf"
CONFIG_MEMFAULT_NCS_DEVICE_ID_RUNTIME=y
CONFIG_MEMFAULT_NCS_HW_VERSION="pinnacle_100_dvk"
CONFIG_MEMFAULT_CLEAR_RESET_REG=n
CONFIG_MEMFAULT_NCS_FW_VERSION_STATIC=y
# Increase tx buffers with callback to support file upload
CONFIG_BT_CONN_TX_MAX=16
```

## app/child_image/hci_rpmsg/boards/bl5340_dvk_cpunet.conf
```kconfig
CONFIG_LOG=y

CONFIG_BT_EXT_ADV=y
CONFIG_BT_EXT_ADV_LEGACY_SUPPORT=y
CONFIG_BT_EXT_ADV_MAX_ADV_SET=1
CONFIG_BT_BUF_ACL_TX_SIZE=251
CONFIG_BT_BUF_ACL_TX_COUNT=7
CONFIG_BT_BUF_ACL_RX_COUNT=7
CONFIG_BT_BUF_CMD_TX_COUNT=7
CONFIG_BT_CTLR_DUP_FILTER_LEN=8
CONFIG_BT_CTLR_RX_BUFFERS=7
CONFIG_BT_CTLR_LE_PING=n
CONFIG_BT_CTLR_DATA_LENGTH_MAX=251

# Workaround for bug #19055 Network core receives 259-byte payload from advertising start message
CONFIG_BT_BUF_ACL_RX_SIZE=300
```

## app/child_image/hci_rpmsg/boards/bl5340pa_dvk_cpunet.conf
```kconfig
CONFIG_BT_EXT_ADV=y
CONFIG_BT_EXT_ADV_LEGACY_SUPPORT=y
CONFIG_BT_EXT_ADV_MAX_ADV_SET=1
CONFIG_BT_BUF_ACL_TX_SIZE=251
CONFIG_BT_BUF_ACL_TX_COUNT=7
CONFIG_BT_BUF_ACL_RX_COUNT=7
CONFIG_BT_BUF_CMD_TX_COUNT=7
CONFIG_BT_CTLR_DUP_FILTER_LEN=8
CONFIG_BT_CTLR_RX_BUFFERS=7
CONFIG_BT_CTLR_LE_PING=n
CONFIG_BT_CTLR_DATA_LENGTH_MAX=251

# Workaround for bug #19055 Network core receives 259-byte payload from advertising start message
CONFIG_BT_BUF_ACL_RX_SIZE=300

# RPMSG
CONFIG_LCZ_RPMSG=y
CONFIG_LCZ_RPMSG_MAX_MESSAGE_SIZE=8
CONFIG_RPMSG_SERVICE_NUM_ENDPOINTS=4

# BL5340PA features
CONFIG_LCZ=y
CONFIG_LCZ_DRIVER=y
CONFIG_LCZ_BL5340PA=y
```

## app/coap/Kconfig
```kconfig
# Copyright (c) 2020 Laird Connectivity
# SPDX-License-Identifier: Apache-2.0

config COAP_FOTA
    bool "Support FOTA using Laird Connectivity CoAP Bridge"
    depends on LCZ_DNS
    depends on LCZ_QRTC
    depends on FILE_SYSTEM_UTILITIES
    depends on DNS_RESOLVER
    depends on NET_SOCKETS
    depends on NET_SOCKETS_ENABLE_DTLS
    depends on MCUMGR_CMD_IMG_MGMT
    depends on REBOOT
    depends on MODEM_HL7800
    depends on BLUEGRASS

if COAP_FOTA

config COAP_FOTA_DEFAULT_BRIDGE
    string "Default host name for retrieving firmware"
    default "cali-test.na-crotalinae.com"
    help
        This value can be changed in the shadow.

config COAP_FOTA_MAX_REQUEST_SIZE
    int "Maximum CoAP FOTA request size"
    default 192

config COAP_FOTA_MAX_RESPONSE_SIZE
    int "Maximum CoAP FOTA response size"
    default 1056
    help
        This must be larger than the block size and header and
        the size of any response message.

config COAP_FOTA_MAX_BLOCK_SIZE
    int "Maximum payload size (enumeration) for block-wise transfers"
    range 0 6
    default 6
    help
        0 is 16, 32, 64, 128, 256, 512, 6 is 1024

config COAP_FOTA_BASE64
    bool "Download is in Base64 format"

config COAP_FOTA_BASE64_TO_BIN_SIZE
    int
    depends on COAP_FOTA_BASE64
    default 12 if COAP_FOTA_MAX_BLOCK_SIZE = 0
    default 24 if COAP_FOTA_MAX_BLOCK_SIZE = 1
    default 48 if COAP_FOTA_MAX_BLOCK_SIZE = 2
    default 96 if COAP_FOTA_MAX_BLOCK_SIZE = 3
    default 192 if COAP_FOTA_MAX_BLOCK_SIZE = 4
    default 384 if COAP_FOTA_MAX_BLOCK_SIZE = 5
    default 768 if COAP_FOTA_MAX_BLOCK_SIZE = 6
    help
        3/4 of base64 size.

config COAP_FOTA_HEXDUMP
    bool "Dump Hex Rx/Tx messages"

config COAP_FOTA_MAX_NAME_SIZE
    int
    default 16
    help
        The maximum size of any JSON name in the shadow.
        The maximum size of the name string in &<name>=1.2.0 (app, hl7800)

config COAP_FOTA_MAX_PARAMETER_SIZE
    int "A generic max size for CoAP string parameters"
    default 64
    help
        The maximum size of the parameter string in &release=<parameter>
        The maximum size of the domain string in coap://<domain>/fw?
        The maximum size of the path string in coap://domain.com/<path>?
        The maximum size of the name of the CoAP bridge.

config COAP_FOTA_RESPONSE_TIMEOUT_MS
    int "The amount of time to wait for a response from the CoAP bridge"
    default 4000

config COAP_FOTA_PATH
    string "Path used in query"
    default "Stage/fw"

config COAP_FOTA_PRODUCT
    string "Product ID used in query"
    default "Sentrius-MG100"
    help
        Pinnacle-100-DVK
        Sentrius-MG100

config COAP_FOTA_PORT
    int "Port used for CoAP communication"
    default 5684

config COAP_FOTA_CA_TAG
    int "Tag used by TLS for referencing root CA credentials"
    default 1
    help
        Should be unique in the system.

config COAP_FOTA_CLIENT_TAG
    int "Tag used by TLS for referencing device (CoAP client) credentials"
    default 2
    help
        Should be unique in the system.

config COAP_FOTA_USE_PSK
    bool "Use shared key instead of certificates"

if COAP_FOTA_USE_PSK

config COAP_FOTA_PSK_ID
    string
    default "password"

config COAP_FOTA_PSK
    string
    default "sesame"

endif

config COAP_FOTA_DELETE_FILE_AFTER_UPDATE
    bool "Delete file after update is complete"
    default y
    help
        Keeping files makes it easy to switch between versions.
        However, currently files can only be deleted using a terminal
        or Bluetooth application (phone).

config COAP_FOTA_ERROR_DELAY
    int "Seconds to wait before trying again after and error occurs."
    default 60
    help
        This allows time for the shadow to be updated.

config COAP_FOTA_MODEM_INSTALL_DELAY
    int "Seconds to wait to allow modem to install update"
    default 600
    help
        Used to prevent starting duplicate update cycle while the modem reboots by
        keeping cloud state machine in FOTA state until modem has rebooted.

endif # COAP_FOTA
```

## app/common/Kconfig
```kconfig
rsource "./Kconfig.aws"
rsource "./Kconfig.app_update"
rsource "./Kconfig.ble"
rsource "./Kconfig.button"
rsource "./Kconfig.fota_smp"
rsource "./Kconfig.gateway_common"
rsource "./Kconfig.http_file_download"
rsource "./Kconfig.jsmn"
rsource "./Kconfig.lairdconnect_battery"
rsource "./Kconfig.lcz_certs"
rsource "./Kconfig.lcz_motion"
rsource "./Kconfig.lcz_motion_temperature"
rsource "./Kconfig.lcz_mqtt"
rsource "./Kconfig.lte"
rsource "./Kconfig.shadow_parser"
rsource "./Kconfig.single_peripheral"
rsource "./Kconfig.sntp"
```

## app/common/Kconfig.app_update
```kconfig
# Copyright (c) 2022 Laird Connectivity
# SPDX-License-Identifier: Apache-2.0

config APP_UPDATE
    bool "Enable application update from file system"
    depends on FILE_SYSTEM_UTILITIES
    depends on BOOTLOADER_MCUBOOT
    depends on IMG_MANAGER

module=APP_UPDATE
module-dep=LOG
module-str=APP_UPDATE
source "${ZEPHYR_BASE}/subsys/logging/Kconfig.template.log_config"

if APP_UPDATE

endif # APP_UPDATE
```

## app/common/Kconfig.aws
```kconfig
# Copyright (c) 2021-2022 Laird Connectivity
# SPDX-License-Identifier: Apache-2.0

menuconfig AWS
    bool "Config AWS (MQTT) Module"
    select LCZ_MQTT

if AWS

config AWS_TOPIC_MAX_SIZE
    int "Maximum size for generated AWS topic strings"
    default 64

module=AWS
module-dep=LOG
module-str=AWS
source "${ZEPHYR_BASE}/subsys/logging/Kconfig.template.log_config"

endif # AWS
```

## app/common/Kconfig.ble
```kconfig
# Copyright (c) 2021 Laird Connectivity
# SPDX-License-Identifier: Apache-2.0

menuconfig BLE
    bool "Enable BLE module"
    default y if BT

if BLE

config BLE_INIT_PRIORITY
    int "SYS_INIT priority (Application Level) of BLE Enable"
    default 20
    help
        This should be initialized early so that other modules can call Bluetooth functions.

config BLE_LOG_LEVEL
    int "Log level for BLE module"
    range 0 4
    default 3

config BLE_NUMBER_OF_DIGITS_TO_USE_IN_DEV_NAME
    int "The number of digits of that are used in ble device name and advertisement"
    default 7

endif # BLE
```

## app/common/Kconfig.fota_smp
```kconfig
# Copyright (c) 2022 Laird Connectivity
# SPDX-License-Identifier: Apache-2.0

config FOTA_SMP
    bool "Enable application update from file system"
    depends on FILE_SYSTEM_UTILITIES
    depends on ATTR

module=FOTA_SMP
module-dep=LOG
module-str=FOTA_SMP
source "${ZEPHYR_BASE}/subsys/logging/Kconfig.template.log_config"
```

## app/common/Kconfig.gateway_common
```kconfig
# Copyright (c) 2022 Laird Connectivity
# SPDX-License-Identifier: Apache-2.0

menuconfig GATEWAY_COMMON
    bool "Enable Gateway Common Module"
    default y

if GATEWAY_COMMON

config GATEWAY_COMMON_NV_DEPRECATION_HANDLER
    bool "Read values stored in NV system into LFS"
    help
      Used when upgrading from version of firmware that used NV

module=GATEWAY_COMMON
module-dep=LOG
module-str=GATEWAY_COMMMON
source "${ZEPHYR_BASE}/subsys/logging/Kconfig.template.log_config"

#
# The following 4 values are used to save NV information into
# the filesystem to allow deprecation of the NV system.
#
config APP_COMMISSIONED_FILE_NAME
    string
    default "commissioned.bin"

config APP_CLIENT_ID_FILE_NAME
    string
    default "client_id.txt"

config APP_ENDPOINT_FILE_NAME
    string
    default "endpoint.txt"

config APP_TOPIC_PREFIX_FILE_NAME
    string
    default "topic_prefix.txt"

endif # BLE
```
