## CMakeLists.txt
```
cmake_minimum_required(VERSION 3.13.1)
include($ENV{ZEPHYR_BASE}/cmake/app/boilerplate.cmake NO_POLICY_SCOPE)
project(oob_demo)

FILE(GLOB app_sources src/*.c)
target_sources(app PRIVATE ${app_sources})
include_directories(${CMAKE_SOURCE_DIR}/include)
zephyr_include_directories(${ZEPHYR_BASE}/drivers/modem)

zephyr_library_include_directories($ENV{ZEPHYR_BASE}/samples/bluetooth)
```

## prj.conf
```kconfig
# General
CONFIG_MAIN_STACK_SIZE=4096
CONFIG_NEWLIB_LIBC=y
CONFIG_NEWLIB_LIBC_FLOAT_PRINTF=y
# Change this to 0 if not using Laird bootloader
CONFIG_FLASH_LOAD_OFFSET=0x1000

# Bluetooth
CONFIG_BT=y
CONFIG_BT_CTLR_TX_PWR_PLUS_8=y
CONFIG_BT_CTLR_COMPANY_ID=0x0077
CONFIG_BT_MAX_CONN=2
CONFIG_BT_CTLR_DATA_LENGTH_MAX=251
CONFIG_BT_L2CAP_TX_MTU=260
CONFIG_BT_RX_BUF_LEN=260
# BLE Central settings
CONFIG_BT_CENTRAL=y
CONFIG_BT_GATT_CLIENT=y
# BLE Peripheral settings
CONFIG_BT_PERIPHERAL=y
CONFIG_BT_DEVICE_NAME="Pinnacle 100 OOB"
CONFIG_BT_DEVICE_NAME_DYNAMIC=y
# BLE security
# CONFIG_BT_SMP=y
# CONFIG_BT_BONDABLE=n
# CONFIG_BT_SMP_ENFORCE_MITM=n
# CONFIG_BT_MAX_PAIRED=1
# CONFIG_BT_TINYCRYPT_ECC=n
# BLE debug
# CONFIG_BT_DEBUG_LOG=y

# modem settings
# CONFIG_MODEM_LOG_LEVEL_DBG=y

# NETWORKING
CONFIG_NET_MGMT=y
CONFIG_NET_MGMT_EVENT=y
CONFIG_NET_SOCKETS=y
CONFIG_NET_SOCKETS_POSIX_NAMES=y
CONFIG_NET_TCP=y
# Enable the DNS resolver
CONFIG_DNS_RESOLVER=y

# MQTT
CONFIG_MQTT_LIB=y
# Security
CONFIG_MQTT_LIB_TLS=y
CONFIG_NET_SOCKETS_SOCKOPT_TLS=y
# TLS configuration
CONFIG_MBEDTLS=y
CONFIG_MBEDTLS_BUILTIN=y
CONFIG_MBEDTLS_ENABLE_HEAP=y
CONFIG_MBEDTLS_HEAP_SIZE=50000
CONFIG_MBEDTLS_SSL_MAX_CONTENT_LEN=8192
CONFIG_MBEDTLS_PEM_CERTIFICATE_FORMAT=y

# JSON
CONFIG_JSON_LIBRARY=y

# Storage
CONFIG_NVS=y
CONFIG_NVS_PROTECT_FLASH=y
CONFIG_MPU_ALLOW_FLASH_WRITE=y
CONFIG_FLASH=y
CONFIG_FCB=y
CONFIG_FLASH_MAP=y
CONFIG_FLASH_PAGE_LAYOUT=y

# command line shell
CONFIG_SHELL=y
CONFIG_SHELL_CMD_BUFF_SIZE=2100
CONFIG_SHELL_BACKEND_SERIAL_RX_RING_BUFFER_SIZE=2100

# DEBUGGING
# Use one of the following two options if debugging with breakpoints
# CONFIG_NO_OPTIMIZATIONS=y
# CONFIG_DEBUG_OPTIMIZATIONS=y
# turn on log system
CONFIG_LOG=y
# extra logging buffer for better debug
CONFIG_LOG_STRDUP_MAX_STRING=128
CONFIG_LOG_STRDUP_BUF_COUNT=20
# networking debug
# CONFIG_NET_LOG=y
# CONFIG_NET_SOCKETS_LOG_LEVEL_DBG=y
# CONFIG_MBEDTLS_DEBUG=y
# CONFIG_MBEDTLS_DEBUG_LEVEL=2
# CONFIG_NET_MGMT_EVENT_LOG_LEVEL_DBG=y
CONFIG_THREAD_NAME=y

# Bootloader query functionality
CONFIG_HAS_LAIRDCONNECTIVITY=y
CONFIG_LAIRDCONNECTIVITY_UWG=y
CONFIG_LAIRDCONNECTIVITY_MSC=y
CONFIG_LAIRDCONNECTIVITY_BLR=y
# disables bootloader verification, debug use only
# CONFIG_LAIRDCONNECTIVITY_BLR_SKIP_CHECKSUM_VERIFY=y

# ADC for power measurement
CONFIG_ADC_0=y
CONFIG_ADC=y
CONFIG_ADC_CONFIGURABLE_INPUTS=y
CONFIG_ADC_NRFX_SAADC=y

# Allows rebooting the module from BLE
CONFIG_REBOOT=y
```

## src/main.c
```c
/* main.c - Application main entry point
 *
 * Copyright (c) 2019 Laird Connectivity
 *
 * SPDX-License-Identifier: Apache-2.0
 */

#include <logging/log.h>
#define LOG_LEVEL LOG_LEVEL_DBG
LOG_MODULE_REGISTER(oob_main);

#include <stdio.h>
#include <zephyr/types.h>
#include <stddef.h>
#include <errno.h>
#include <zephyr.h>
#include <version.h>
#include <shell/shell.h>
#include <shell/shell_uart.h>

#include "oob_common.h"
#include "led.h"
#include "oob_ble.h"
#include "lte.h"
#include "aws.h"
#include "nv.h"
#include "ble_cellular_service.h"
#include "ble_aws_service.h"
#include "ble_sensor_service.h"
#include "ble_power_service.h"
#include "power.h"
#include "dis.h"
#include "bootloader.h"

#define MAIN_LOG_ERR(...) LOG_ERR(__VA_ARGS__)
#define MAIN_LOG_WRN(...) LOG_WRN(__VA_ARGS__)
#define MAIN_LOG_INF(...) LOG_INF(__VA_ARGS__)
#define MAIN_LOG_DBG(...) LOG_DBG(__VA_ARGS__)

/* This is a callback function which is called when the send data timer has expired */
static void SendDataTimerExpired(struct k_timer *dummy);

static void appStateAwsSendSensorData(void);
static void appStateAwsInitShadow(void);
static void appStateAwsConnect(void);
static void appStateAwsDisconnect(void);
static void appStateAwsResolveServer(void);
static void appStateWaitForLte(void);
static void appStateCommissionDevice(void);
static void appStateWaitForSensorData(void);

static void setAwsStatusWrapper(struct bt_conn *conn, enum aws_status status);

K_TIMER_DEFINE(SendDataTimer, SendDataTimerExpired, NULL);
K_SEM_DEFINE(send_data_sem, 0, 1);
K_MUTEX_DEFINE(sensor_data_lock);
K_SEM_DEFINE(lte_ready_sem, 0, 1);
K_SEM_DEFINE(rx_cert_sem, 0, 1);

static float temperatureReading = 0;
static float humidityReading = 0;
static u32_t pressureReading = 0;
static bool initShadow = true;
static bool sendSensorDataAsap = true;
static bool resolveAwsServer = true;

static bool bUpdatedTemperature = false;
static bool bUpdatedHumidity = false;
static bool bUpdatedPressure = false;

static bool commissioned;
static bool allowCommissioning = false;
static bool appReady = false;
static bool devCertSet;
static bool devKeySet;

static app_state_function_t appState;
struct lte_status *lteInfo;

/* Turn the LED off for 1 second when data is sent.
 * This pattern assumes LED is already on an will be turned back on by the 
 * pattern complete callback.
 */
static const struct led_blink_pattern LED_BLIP_PATTERN = { .on_time = K_MSEC(1),
							   .off_time =
								   K_SECONDS(1),
							   .repeat_count = 1 };

static void startSendDataTimer(void)
{
	/* Start the recurring data sending timer */
	k_timer_start(&SendDataTimer, K_SECONDS(DATA_SEND_TIME_SECONDS),
		      K_SECONDS(DATA_SEND_TIME_SECONDS));
}

static void stopSendDataTimer(void)
{
	k_timer_stop(&SendDataTimer);
}

/* This is a callback function which is called when the send data timer has expired */
static void SendDataTimerExpired(struct k_timer *dummy)
{
	if (bUpdatedTemperature && bUpdatedHumidity && bUpdatedPressure) {
		bUpdatedTemperature = false;
		bUpdatedHumidity = false;
		bUpdatedPressure = false;
		// All sensor readings have been received
		k_sem_give(&send_data_sem);
	}
}

/* This is a callback function which receives sensor readings */
static void SensorUpdated(u8_t sensor, s32_t reading)
{
	k_mutex_lock(&sensor_data_lock, K_FOREVER);
	if (sensor == SENSOR_TYPE_TEMPERATURE) {
		// Divide by 100 to get xx.xxC format
		temperatureReading = reading / 100.0;
		bUpdatedTemperature = true;
	} else if (sensor == SENSOR_TYPE_HUMIDITY) {
		// Divide by 100 to get xx.xx% format
		humidityReading = reading / 100.0;
		bUpdatedHumidity = true;
	} else if (sensor == SENSOR_TYPE_PRESSURE) {
		// Divide by 10 to get x.xPa format
		pressureReading = reading / 10;
		bUpdatedPressure = true;
	}
	k_mutex_unlock(&sensor_data_lock);
	if (sendSensorDataAsap && bUpdatedTemperature && bUpdatedHumidity &&
	    bUpdatedPressure) {
		sendSensorDataAsap = false;
		k_sem_give(&send_data_sem);
		startSendDataTimer();
	}
}

static void lteEvent(enum lte_event event)
{
	switch (event) {
	case LTE_EVT_READY:
		k_sem_give(&lte_ready_sem);
		break;
	case LTE_EVT_DISCONNECTED:
		/* No need to trigger a reconnect.
		*  If next sensor data TX fails we will reconnect. 
		*/
		break;
	}
}

static void appStateAwsSendSensorData(void)
{
	int rc = 0;

	MAIN_LOG_DBG("AWS send sensor data state");

	/* If decommissioned then disconnect.
	 * If disconnected then still go through the disconnect state so that the send
	 * data timer is disabled.
	 */
	if (!commissioned || !awsConnected()) {
		appState = appStateAwsDisconnect;
		return;
	}

	setAwsStatusWrapper(oob_ble_get_central_connection(),
			    AWS_STATUS_CONNECTED);

	int take =
		k_sem_take(&send_data_sem, K_SECONDS(DATA_SEND_TIME_SECONDS));
	if (take == 0) {
		lteInfo = lteGetStatus();

		k_mutex_lock(&sensor_data_lock, K_FOREVER);
		MAIN_LOG_INF("Sending Sensor data t:%d, h:%d, p:%d...",
			     (int)(temperatureReading * 100),
			     (int)(humidityReading * 100), pressureReading);
		rc = awsPublishSensorData(temperatureReading, humidityReading,
					  pressureReading, lteInfo->rssi,
					  lteInfo->sinr);
		if (rc != 0) {
			MAIN_LOG_ERR("Could not send sensor data (%d)", rc);
			appState = appStateAwsDisconnect;
		} else {
			MAIN_LOG_INF("Data sent");
			led_blink(GREEN_LED2, &LED_BLIP_PATTERN);
		}

		k_mutex_unlock(&sensor_data_lock);
	}
}

static void appStateAwsInitShadow(void)
{
	int rc;

	MAIN_LOG_DBG("AWS init shadow state");

	/* Fill in base shadow info and publish */
	awsSetShadowAppFirmwareVersion(APP_VERSION_STRING);
	awsSetShadowKernelVersion(KERNEL_VERSION_STRING);
	awsSetShadowIMEI(lteInfo->IMEI);
	awsSetShadowICCID(lteInfo->ICCID);
	awsSetShadowRadioFirmwareVersion(lteInfo->radio_version);
	awsSetShadowRadioSerialNumber(lteInfo->serialNumber);

	MAIN_LOG_INF("Send persistent shadow data");
	rc = awsPublishShadowPersistentData();
	if (rc != 0) {
		appState = appStateAwsDisconnect;
		goto exit;
	}
	initShadow = false;
	/* The shadow init is only sent once after the very first connect.
	*  we want to send the first sensor data ASAP after the shadow is inited
	*/
	sendSensorDataAsap = true;
	appState = appStateAwsSendSensorData;
exit:
	return;
}

static void appStateAwsConnect(void)
{
	MAIN_LOG_DBG("AWS connect state");

	if (!lteIsReady()) {
		appState = appStateWaitForLte;
		return;
	}

	if (awsConnect() != 0) {
		MAIN_LOG_ERR("Could not connect to aws, retrying in %d seconds",
			     RETRY_AWS_ACTION_TIMEOUT_SECONDS);
		setAwsStatusWrapper(oob_ble_get_central_connection(),
				    AWS_STATUS_CONNECTION_ERR);
		/* wait some time before trying again */
		k_sleep(K_SECONDS(RETRY_AWS_ACTION_TIMEOUT_SECONDS));
		return;
	}

	nvStoreCommissioned(true);
	commissioned = true;
	allowCommissioning = false;

	setAwsStatusWrapper(oob_ble_get_central_connection(),
			    AWS_STATUS_CONNECTING);

	if (initShadow) {
		/* Init the shadow once, the first time we connect */
		appState = appStateAwsInitShadow;
	} else {
		/* after a connection we want to send the first sensor data ASAP */
		sendSensorDataAsap = true;
		appState = appStateAwsSendSensorData;
	}
}

static bool areCertsSet(void)
{
	return (devCertSet && devKeySet);
}

static void appStateAwsDisconnect(void)
{
	MAIN_LOG_DBG("AWS disconnect state");
	setAwsStatusWrapper(oob_ble_get_central_connection(),
			    AWS_STATUS_DISCONNECTED);
	stopSendDataTimer();
	awsDisconnect();
	appState = appStateWaitForSensorData;
}

/* On startup there is configuration data to send to AWS.
 * However, if there isn't sensor data to send then the connection will be
 * closed.  Wait for sensor data before re-opening connection.
 */
static void appStateWaitForSensorData(void)
{
	MAIN_LOG_DBG("AWS Wait For Sensor Data state");

	k_sem_take(&send_data_sem, K_FOREVER);

	if (areCertsSet()) {
		appState = appStateAwsConnect;
	} else {
		appState = appStateCommissionDevice;
	}
}

static void appStateAwsResolveServer(void)
{
	MAIN_LOG_DBG("AWS resolve server state");

	if (!lteIsReady()) {
		appState = appStateWaitForLte;
		return;
	}

	if (awsGetServerAddr() != 0) {
		MAIN_LOG_ERR(
			"Could not get server address, retrying in %d seconds",
			RETRY_AWS_ACTION_TIMEOUT_SECONDS);
		/* wait some time before trying again */
		k_sleep(K_SECONDS(RETRY_AWS_ACTION_TIMEOUT_SECONDS));
		return;
	}
	resolveAwsServer = false;
	appState = appStateAwsConnect;
}

static void appStateWaitForLte(void)
{
	MAIN_LOG_DBG("Wait for LTE state");

	setAwsStatusWrapper(oob_ble_get_central_connection(),
			    AWS_STATUS_DISCONNECTED);

	if (!lteIsReady()) {
		/* Wait for LTE read evt */
		k_sem_reset(&lte_ready_sem);
		k_sem_take(&lte_ready_sem, K_FOREVER);
	}

	if (resolveAwsServer && areCertsSet()) {
		appState = appStateAwsResolveServer;
	} else if (areCertsSet()) {
		appState = appStateAwsConnect;
	} else {
		appState = appStateCommissionDevice;
	}
}

static int setAwsCredentials(void)
{
	int rc;

	if (!aws_svc_client_cert_is_stored()) {
		return APP_ERR_READ_CERT;
	}

	if (!aws_svc_client_key_is_stored()) {
		return APP_ERR_READ_KEY;
	}
	devCertSet = true;
	devKeySet = true;
	rc = awsSetCredentials(aws_svc_get_client_cert(),
			       aws_svc_get_client_key());
	return rc;
}

static void appStateCommissionDevice(void)
{
	MAIN_LOG_DBG("Commission device state");
	printk("\n\nWaiting to commission device\n\n");
	setAwsStatusWrapper(oob_ble_get_central_connection(),
			    AWS_STATUS_NOT_PROVISIONED);
	allowCommissioning = true;

	k_sem_take(&rx_cert_sem, K_FOREVER);
	if (setAwsCredentials() == 0) {
		appState = appStateWaitForLte;
	}
}

char *replaceWord(const char *s, const char *oldW, const char *newW, char *dest,
		  int destSize)
{
	int i, cnt = 0;
	int newWlen = strlen(newW);
	int oldWlen = strlen(oldW);

	/* Counting the number of times old word
	*  occur in the string 
	*/
	for (i = 0; s[i] != '\0'; i++) {
		if (strstr(&s[i], oldW) == &s[i]) {
			cnt++;

			/* Jumping to index after the old word. */
			i += oldWlen - 1;
		}
	}

	/* Make sure new string isn't too big */
	if ((i + cnt * (newWlen - oldWlen) + 1) > destSize) {
		return NULL;
	}

	i = 0;
	while (*s) {
		/* compare the substring with the result */
		if (strstr(s, oldW) == s) {
			strcpy(&dest[i], newW);
			i += newWlen;
			s += oldWlen;
		} else {
			dest[i++] = *s++;
		}
	}

	dest[i] = '\0';
	return dest;
}

static void decommission(void)
{
	nvStoreCommissioned(false);
	devCertSet = false;
	devKeySet = false;
	commissioned = false;
	allowCommissioning = true;
	appState = appStateAwsDisconnect;
	printk("Device is decommissioned\n");
}

static void awsSvcEvent(enum aws_svc_event event)
{
	switch (event) {
	case AWS_SVC_EVENT_SETTINGS_SAVED:
		devCertSet = true;
		devKeySet = true;
		k_sem_give(&rx_cert_sem);
		break;
	case AWS_SVC_EVENT_SETTINGS_CLEARED:
		decommission();
		break;
	}
}

/* When data is sent the LED is turned off for 1 second and then turned back
 * on.
 */
static void ledPatternCompleteCallback(void)
{
	led_turn_on(GREEN_LED2);
}

static void setAwsStatusWrapper(struct bt_conn *conn, enum aws_status status)
{
	aws_svc_set_status(conn, status);

	if (status == AWS_STATUS_CONNECTED) {
		if (!led_pattern_busy(GREEN_LED2)) {
			led_turn_on(GREEN_LED2);
		}
	} else {
		led_turn_off(GREEN_LED2);
	}
}

#ifdef CONFIG_SHELL
static int shellSetCert(enum CREDENTIAL_TYPE type, u8_t *cred)
{
	int rc;
	int certSize;
	int expSize = 0;
	char *newCred = NULL;

	if (!appReady) {
		printk("App is not ready\n");
		return APP_ERR_NOT_READY;
	}

	if (!allowCommissioning) {
		printk("Not ready for commissioning, decommission device first\n");
		return APP_ERR_COMMISSION_DISALLOWED;
	}

	certSize = strlen(cred);

	if (type == CREDENTIAL_CERT) {
		expSize = AWS_CLIENT_CERT_MAX_LENGTH;
		newCred = (char *)aws_svc_get_client_cert();
	} else if (type == CREDENTIAL_KEY) {
		expSize = AWS_CLIENT_KEY_MAX_LENGTH;
		newCred = (char *)aws_svc_get_client_key();
	} else {
		return APP_ERR_UNKNOWN_CRED;
	}

	if (certSize > expSize) {
		printk("Cert is too large (%d)\n", certSize);
		return APP_ERR_CRED_TOO_LARGE;
	}

	replaceWord(cred, "\\n", "\n", newCred, expSize);
	replaceWord(newCred, "\\s", " ", newCred, expSize);

	rc = aws_svc_save_clear_settings(true);
	if (rc < 0) {
		MAIN_LOG_ERR("Error storing credential (%d)", rc);
	} else if (type == CREDENTIAL_CERT) {
		printk("Stored cert:\n%s\n", newCred);
		devCertSet = true;

	} else if (type == CREDENTIAL_KEY) {
		printk("Stored key:\n%s\n", newCred);
		devKeySet = true;
	}

	if (rc >= 0 && areCertsSet()) {
		k_sem_give(&rx_cert_sem);
	}

	return rc;
}

static int shell_set_aws_device_cert(const struct shell *shell, size_t argc,
				     char **argv)
{
	ARG_UNUSED(argc);

	return shellSetCert(CREDENTIAL_CERT, argv[1]);
}

static int shell_set_aws_device_key(const struct shell *shell, size_t argc,
				    char **argv)
{
	ARG_UNUSED(argc);

	return shellSetCert(CREDENTIAL_KEY, argv[1]);
}

static int shell_decommission(const struct shell *shell, size_t argc,
			      char **argv)
{
	ARG_UNUSED(argc);
	ARG_UNUSED(argv);

	if (!appReady) {
		printk("App is not ready\n");
		return APP_ERR_NOT_READY;
	}

	aws_svc_save_clear_settings(false);
	decommission();

	return 0;
}

#ifdef CONFIG_REBOOT
static int shell_reboot(const struct shell *shell, size_t argc,
			      char **argv)
{
	ARG_UNUSED(argc);
	ARG_UNUSED(argv);

	power_reboot_module(REBOOT_TYPE_NORMAL);

	return 0;
}

static int shell_bootloader(const struct shell *shell, size_t argc,
			      char **argv)
{
	ARG_UNUSED(argc);
	ARG_UNUSED(argv);

	power_reboot_module(REBOOT_TYPE_BOOTLOADER);

	return 0;
}
#endif /* CONFIG_REBOOT */
#endif /* CONFIG_SHELL */

void main(void)
{
	int rc;

	/* init LEDS */
	led_init();

	/* Init NV storage */
	rc = nvInit();
	if (rc < 0) {
		MAIN_LOG_ERR("NV init (%d)", rc);
		goto exit;
	}

	nvReadCommissioned(&commissioned);

	/* init LTE */
	lteRegisterEventCallback(lteEvent);
	rc = lteInit();
	if (rc < 0) {
		MAIN_LOG_ERR("LTE init (%d)", rc);
		goto exit;
	}
	lteInfo = lteGetStatus();

	/* init AWS */
	rc = awsInit();
	if (rc != 0) {
		goto exit;
	}
	led_register_pattern_complete_function(GREEN_LED2,
					       ledPatternCompleteCallback);

	dis_initialize();

	/* Start up BLE portion of the demo */
	cell_svc_init();
	cell_svc_assign_connection_handler_getter(
		oob_ble_get_central_connection);
	cell_svc_set_imei(lteInfo->IMEI);
	cell_svc_set_fw_ver(lteInfo->radio_version);
	cell_svc_set_iccid(lteInfo->ICCID);

	bss_init();
	bss_assign_connection_handler_getter(oob_ble_get_central_connection);

	/* Setup the power service */
	power_svc_init();
	power_svc_assign_connection_handler_getter(
		oob_ble_get_central_connection);
	power_init();

	bootloader_init();

	rc = aws_svc_init(lteInfo->IMEI);
	if (rc != 0) {
		goto exit;
	}
	aws_svc_set_event_callback(awsSvcEvent);
	if (commissioned) {
		aws_svc_set_status(NULL, AWS_STATUS_DISCONNECTED);

	} else {
		aws_svc_set_status(NULL, AWS_STATUS_NOT_PROVISIONED);
	}

	oob_ble_initialise(lteInfo->IMEI);
	oob_ble_set_callback(SensorUpdated);

	appReady = true;
	printk("\n!!!!!!!! App is ready! !!!!!!!!\n");

	if (commissioned && setAwsCredentials() == 0) {
		appState = appStateWaitForLte;
	} else {
		appState = appStateCommissionDevice;
	}

	while (true) {
		appState();
	}
exit:
	MAIN_LOG_ERR("Exiting main thread");
	return;
}

#ifdef CONFIG_SHELL
SHELL_STATIC_SUBCMD_SET_CREATE(oob_cmds,
			       SHELL_CMD_ARG(set_cert, NULL, "Set device cert",
					     shell_set_aws_device_cert, 2, 0),
			       SHELL_CMD_ARG(set_key, NULL, "Set device key",
					     shell_set_aws_device_key, 2, 0),
			       SHELL_CMD(reset, NULL,
					 "Factory reset (decommission) device",
					 shell_decommission),
#ifdef CONFIG_REBOOT
			       SHELL_CMD(reboot, NULL,
					 "Reboot module",
					 shell_reboot),
			       SHELL_CMD(bootloader, NULL,
					 "Boot to UART bootloader",
					 shell_bootloader),
#endif
			       SHELL_SUBCMD_SET_END /* Array terminated. */
);
SHELL_CMD_REGISTER(oob, &oob_cmds, "OOB Demo commands", NULL);

static int shell_send_at_cmd(const struct shell *shell, size_t argc,
			     char **argv)
{
	if ((argc == 2) && (argv[1] != NULL)) {
		int result = mdm_hl7800_send_at_cmd(argv[1]);
		if (result < 0) {
			shell_error(shell, "Command not accepted");
		}
	} else {
		shell_error(shell, "Invalid parameter");
		return -EINVAL;
	}
	return 0;
}

SHELL_CMD_REGISTER(at, NULL, "Send an AT command string to the HL7800",
		   shell_send_at_cmd);
#endif /* CONFIG_SHELL */
```

## include/aws.h
```c
/*
 * Copyright (c) 2019 Laird Connectivity
 *
 * SPDX-License-Identifier: Apache-2.0
 */

#ifndef __AWS_H__
#define __AWS_H__

#include <json.h>

#define CA_TAG 1
#define DEVICE_CERT_TAG 2

/* AWS Root CA obtained from 
*  https://docs.aws.amazon.com/iot/latest/developerguide/managing-device-certs.html 
*/
static const unsigned char aws_root_ca[] =
	"-----BEGIN CERTIFICATE-----\n"
	"MIIDQTCCAimgAwIBAgITBmyfz5m/jAo54vB4ikPmljZbyjANBgkqhkiG9w0BAQsF\n"
	"ADA5MQswCQYDVQQGEwJVUzEPMA0GA1UEChMGQW1hem9uMRkwFwYDVQQDExBBbWF6\n"
	"b24gUm9vdCBDQSAxMB4XDTE1MDUyNjAwMDAwMFoXDTM4MDExNzAwMDAwMFowOTEL\n"
	"MAkGA1UEBhMCVVMxDzANBgNVBAoTBkFtYXpvbjEZMBcGA1UEAxMQQW1hem9uIFJv\n"
	"b3QgQ0EgMTCCASIwDQYJKoZIhvcNAQEBBQADggEPADCCAQoCggEBALJ4gHHKeNXj\n"
	"ca9HgFB0fW7Y14h29Jlo91ghYPl0hAEvrAIthtOgQ3pOsqTQNroBvo3bSMgHFzZM\n"
	"9O6II8c+6zf1tRn4SWiw3te5djgdYZ6k/oI2peVKVuRF4fn9tBb6dNqcmzU5L/qw\n"
	"IFAGbHrQgLKm+a/sRxmPUDgH3KKHOVj4utWp+UhnMJbulHheb4mjUcAwhmahRWa6\n"
	"VOujw5H5SNz/0egwLX0tdHA114gk957EWW67c4cX8jJGKLhD+rcdqsq08p8kDi1L\n"
	"93FcXmn/6pUCyziKrlA4b9v7LWIbxcceVOF34GfID5yHI9Y/QCB/IIDEgEw+OyQm\n"
	"jgSubJrIqg0CAwEAAaNCMEAwDwYDVR0TAQH/BAUwAwEB/zAOBgNVHQ8BAf8EBAMC\n"
	"AYYwHQYDVR0OBBYEFIQYzIU07LwMlJQuCFmcx7IQTgoIMA0GCSqGSIb3DQEBCwUA\n"
	"A4IBAQCY8jdaQZChGsV2USggNiMOruYou6r4lK5IpDB/G/wkjUu0yKGX9rbxenDI\n"
	"U5PMCCjjmCXPI6T53iHTfIUJrU6adTrCC2qJeHZERxhlbI1Bjjt/msv0tadQ1wUs\n"
	"N+gDS63pYaACbvXy8MWy7Vu33PqUXHeeE6V/Uq2V8viTO96LXFvKWlJbYK8U90vv\n"
	"o/ufQJVtMVT8QtPHRh8jrdkPSHCa2XV4cdFyQzR1bldZwgJcJmApzyMZFo6IQ6XU\n"
	"5MsI+yMRQ+hDKXJioaldXgjUkK642M4UwtBV8ob2xJNDd2ZhwLnoQdeXeGADbkpy\n"
	"rqXRfboQnoZsG4q5WTP468SQvvG5\n"
	"-----END CERTIFICATE-----\n";

#define AWS_DEFAULT_ENDPOINT "a3273rvo818l4w-ats.iot.us-east-1.amazonaws.com"

#define SERVER_PORT_STR "8883"

#define APP_SLEEP_MSECS 500

#define DNS_RETRIES 1
#define APP_CONNECT_TRIES 1

#define APP_MQTT_BUFFER_SIZE 128

#define DEFAULT_MQTT_CLIENTID "pinnacle100_oob"

#define SHADOW_STATE_NULL "{\"state\":null}"

#define SHADOW_REPORTED_START "{\"state\":{\"reported\":{"
#define SHADOW_REPORTED_END "}}}"

#define SHADOW_TEMPERATURE "\"temperature\":"
#define SHADOW_HUMIDITY "\"humidity\":"
#define SHADOW_PRESSURE "\"pressure\":"
#define SHADOW_RADIO_RSSI "\"radio_rssi\":"
#define SHADOW_RADIO_SINR "\"radio_sinr\":"

#define AWS_RX_THREAD_STACK_SIZE 1024
#define AWS_RX_THREAD_PRIORITY K_PRIO_COOP(1)

struct shadow_persistent_values {
	const char *firmware_version;
	const char *os_version;
	const char *radio_version;
	const char *IMEI;
	const char *ICCID;
	const char *radio_sn;
};

struct shadow_state_reported {
	struct shadow_persistent_values reported;
};

struct shadow_reported_struct {
	struct shadow_state_reported state;
};

static const struct json_obj_descr shadow_persistent_values_descr[] = {
	JSON_OBJ_DESCR_PRIM(struct shadow_persistent_values, firmware_version,
			    JSON_TOK_STRING),
	JSON_OBJ_DESCR_PRIM(struct shadow_persistent_values, os_version,
			    JSON_TOK_STRING),
	JSON_OBJ_DESCR_PRIM(struct shadow_persistent_values, radio_version,
			    JSON_TOK_STRING),
	JSON_OBJ_DESCR_PRIM(struct shadow_persistent_values, IMEI,
			    JSON_TOK_STRING),
	JSON_OBJ_DESCR_PRIM(struct shadow_persistent_values, ICCID,
			    JSON_TOK_STRING),
	JSON_OBJ_DESCR_PRIM(struct shadow_persistent_values, radio_sn,
			    JSON_TOK_STRING),
};

static const struct json_obj_descr shadow_state_reported_descr[] = {
	JSON_OBJ_DESCR_OBJECT(struct shadow_state_reported, reported,
			      shadow_persistent_values_descr),
};

static const struct json_obj_descr shadow_descr[] = {
	JSON_OBJ_DESCR_OBJECT(struct shadow_reported_struct, state,
			      shadow_state_reported_descr),
};

int awsInit(void);
int awsSetCredentials(const u8_t *cert, const u8_t *key);
void awsSetRootCa(const char *cred);
void awsSetEndpoint(const char *ep);
void awsSetClientId(const char *id);
int awsGetServerAddr(void);
int awsConnect();
bool awsConnected(void);
void awsDisconnect(void);
int awsKeepAlive(void);
int awsSendData(char *data);
int awsPublishShadowPersistentData();
int awsSetShadowKernelVersion(const char *version);
int awsSetShadowIMEI(const char *imei);
int awsSetShadowICCID(const char *iccid);
int awsSetShadowRadioSerialNumber(const char *sn);
int awsSetShadowRadioFirmwareVersion(const char *version);
int awsSetShadowAppFirmwareVersion(const char *version);
int awsPublishSensorData(float temperature, float humidity, int pressure,
			 int radioRssi, int radioSinr);

#endif /* __AWS_H__ */
```

## include/ble_aws_service.h
```c
/*
 * Copyright (c) 2019 Laird Connectivity
 *
 * SPDX-License-Identifier: Apache-2.0
 */

#ifndef __BLE_AWS_SERVICE_H__
#define __BLE_AWS_SERVICE_H__

#define AWS_CLIENT_ID_MAX_LENGTH 32
#define AWS_ENDPOINT_MAX_LENGTH 256
#define AWS_ROOT_CA_MAX_LENGTH 2048
#define AWS_CLIENT_CERT_MAX_LENGTH 2048
#define AWS_CLIENT_KEY_MAX_LENGTH 2048

enum aws_status {
	AWS_STATUS_NOT_PROVISIONED = 0,
	AWS_STATUS_DISCONNECTED,
	AWS_STATUS_CONNECTED,
	AWS_STATUS_CONNECTION_ERR,
	AWS_STATUS_CONNECTING
};

enum aws_svc_err {
	AWS_SVC_ERR_NONE = 0,
	AWS_SVC_ERR_INIT_ENDPOINT = -1,
	AWS_SVC_ERR_INIT_CLIENT_ID = -2,
	AWS_SVC_ERR_INIT_ROOT_CA = -3,
};

enum aws_svc_event {
    AWS_SVC_EVENT_SETTINGS_SAVED,
    AWS_SVC_EVENT_SETTINGS_CLEARED,
};

/**
 * @brief Callback function prototype for AWS service events
 * 
 */
typedef void (*aws_svc_event_function_t)(enum aws_svc_event event);

int aws_svc_init(const char *clientId);
void aws_svc_set_client_id(const char *id);
void aws_svc_set_endpoint(const char *ep);
void aws_svc_set_status(struct bt_conn *conn, enum aws_status status);
void aws_svc_set_root_ca(const char *cred);
void aws_svc_set_client_cert(const char *cred);
void aws_svc_set_client_key(const char *cred);
bool aws_svc_client_cert_is_stored(void);
bool aws_svc_client_key_is_stored(void);
const char *aws_svc_get_client_cert(void);
const char *aws_svc_get_client_key(void);
int aws_svc_save_clear_settings(bool save);

/**
 * @brief Set the AWS service callback
 * 
 * @param func Callback function
 */
void aws_svc_set_event_callback(aws_svc_event_function_t func);


#endif
```

## include/ble_bootloader_service.h
```c
/*
 * Copyright (c) 2020 Laird Connectivity
 *
 * SPDX-License-Identifier: Apache-2.0
 */
#ifndef __BLE_BOOTLOADER_SERVICE_H__
#define __BLE_BOOTLOADER_SERVICE_H__

//=============================================================================
// Includes
//=============================================================================

#include <bluetooth/conn.h>
#include <zephyr/types.h>

//=============================================================================
// Global Function Definitions
//=============================================================================

/**
 * @brief Initialise the bootloader service
 */
void bbs_init();

/**
 * @brief Various functions for setting bootloader service data
 */
void bbs_set_bootloader_present(bool present);
void bbs_set_bootloader_state(u8_t state);
void bbs_set_bootloader_header_checked(bool checked);
void bbs_set_error_code(u8_t error);
void bbs_set_bootloader_version(u16_t version);
void bbs_set_bootloader_build_date(u8_t *date);
void bbs_set_ext_function_version(u16_t version);
void bbs_set_ext_header_version(u16_t version);
void bbs_set_customer_key_set(bool set);
void bbs_set_customer_key(u8_t *key);
void bbs_set_readback_protection(bool readback);
void bbs_set_cpu_debug_protection(bool debug);
void bbs_set_QSPI_checked(u8_t checked);
void bbs_set_QSPI_crc(u32_t checked);
void bbs_set_QSPI_sha256(u8_t *sha256);
void bbs_set_bootloader_type(bool type);
void bbs_set_bootloader_update_failures(u8_t failures);
void bbs_set_bootloader_update_last_fail_version(u16_t version);
void bbs_set_bootloader_update_last_fail_code(u8_t code);
void bbs_set_bootloader_updates_applied(u16_t updates);
void bbs_set_bootloader_section_updates_applied(u16_t updates);
void bbs_set_bootloader_modem_updates_applied(u16_t updates);
void bbs_set_bootloader_modem_update_last_fail_version(u16_t version);
void bbs_set_bootloader_modem_update_last_fail_code(u8_t code);
void bbs_set_bootloader_compression_errors(u8_t errors);
void bbs_set_bootloader_compression_last_fail_code(u16_t code);
void bbs_set_module_build_date(uint8_t *date);
void bbs_set_firmware_build_date(uint8_t *date);
void bbs_set_boot_verification(u8_t verification);

#endif /* __BLE_BOOTLOADER_SERVICE_H__ */
```

## include/ble_cellular_service.h
```c
/*
 * Copyright (c) 2019 Laird Connectivity
 *
 * SPDX-License-Identifier: Apache-2.0
 */

#ifndef __BLE_CELLULAR_SERVICE_H__
#define __BLE_CELLULAR_SERVICE_H__

#include <drivers/modem/hl7800.h>
#include <bluetooth/conn.h>
#include <zephyr/types.h>

/** @param function that sensor service should use to get connection handle when
 * determining if a value should by notified.
 */
void cell_svc_assign_connection_handler_getter(
	struct bt_conn *(*function)(void));

void cell_svc_init();
void cell_svc_set_imei(const char *imei);
void cell_svc_set_network_state(u8_t state);
void cell_svc_set_startup_state(u8_t state);
void cell_svc_set_sleep_state(u8_t state);
void cell_svc_set_apn(struct mdm_hl7800_apn *access_point);
void cell_svc_set_rssi(int value);
void cell_svc_set_sinr(int value);
void cell_svc_set_fw_ver(const char *ver);
void cell_svc_set_rat(u8_t value);
void cell_svc_set_iccid(const char *value);

#endif
```

## include/dis.h
```c
/*
 * Copyright (c) 2020 Laird Connectivity
 *
 * SPDX-License-Identifier: Apache-2.0
 */

#ifndef DIS_H
#define DIS_H

#ifdef __cplusplus
extern "C" {
#endif

//=============================================================================
// Includes
//=============================================================================

//=============================================================================
// Global Constants, Macros and Type Definitions
//=============================================================================
// NA

//=============================================================================
// Global Data Definitions
//=============================================================================
// NA

//=============================================================================
// Global Function Prototypes
//=============================================================================

//-----------------------------------------------
//! @brief Reads Zephyr version and
//! registers the service with the Bluetooth stack.
//!
void dis_initialize(void);

#ifdef __cplusplus
}
#endif

#endif

// end
```

## include/hexcode.h
```c
/*
 * Copyright (c) 2020 Laird Connectivity
 *
 * SPDX-License-Identifier: Apache-2.0
 */
#ifndef __HEXCODE_H__
#define __HEXCODE_H__

//=============================================================================
// Includes
//=============================================================================
#include <stdint.h>
#include <stdbool.h>
#include <string.h>
#include <zephyr/types.h>

//=============================================================================
// Local Constant, Macro and Type Definitions
//=============================================================================
#define HEX_DECODE_LOWER_CASE_ALPHA_SUBTRACT      0x57
#define HEX_DECODE_UPPER_CASE_ALPHA_SUBTRACT      0x37
#define HEX_DECODE_NUMERIC_SUBTRACT               0x30
#define HEX_ENCODE_LOWER_CASE_ALPHA_ADDITION      0x27
#define HEX_ENCODE_UPPER_CASE_ALPHA_ADDITION      0x7
#define HEX_ENCODE_NUMERIC_ADDITION               0x30

//=============================================================================
// Global Function Definitions
//=============================================================================
void HexEncode(u8_t *pInput, u32_t nLength, u8_t *pOutput, bool bUpperCase,
	       bool bWithNullTermination);

#endif /* __HEXCODE_H__ */
```

## include/laird_bluetooth.h
```c
/*
 * Copyright (c) 2020 Laird Connectivity
 *
 * SPDX-License-Identifier: Apache-2.0
 */

#include <bluetooth/gatt.h>
#include <bluetooth/bluetooth.h>
#include <zephyr/types.h>

#define IS_NOTIFIABLE(v) ((v) == BT_GATT_CCC_NOTIFY) ? true : false;

/** The upper 8 bits of a 16 bit value */
#define MSB_16(a) (((a)&0xFF00) >> 8)
/** The lower 8 bits (of a 16 bit value) */
#define LSB_16(a) ((a)&0x00FF)

/* Client Characteristic Configuration Descriptor */
struct lbt_ccc_element {
	struct bt_gatt_ccc_cfg cfg[BT_GATT_CCC_MAX];
	bool notify;
};

/* Link a CCC handler 
 * assumes lbt_ccc_element array named ccc
 * and a function of the form name_ccc_handler
 */
#define LBT_GATT_CCC(name) BT_GATT_CCC(ccc.name.cfg, name##_ccc_handler)

/**
 *  @brief Helper function for reading a byte from the Bluetooth stack.
 */
ssize_t lbt_read_u8(struct bt_conn *conn, const struct bt_gatt_attr *attr,
		    void *buf, u16_t len, u16_t offset);

/**
 *  @brief Helper function for reading a uint16 from the Bluetooth stack.
 */
ssize_t lbt_read_u16(struct bt_conn *conn, const struct bt_gatt_attr *attr,
		    void *buf, u16_t len, u16_t offset);

/**
 *  @brief Helper function for reading a uint32 from the Bluetooth stack.
 */
ssize_t lbt_read_u32(struct bt_conn *conn, const struct bt_gatt_attr *attr,
		    void *buf, u16_t len, u16_t offset);

/**
 *  @brief Helper function for reading an integer from the Bluetooth stack.
 */
ssize_t lbt_read_integer(struct bt_conn *conn, const struct bt_gatt_attr *attr,
			 void *buf, u16_t len, u16_t offset);

/**
 *  @brief Helper function for reading a string characteristic from 
 * the Bluetooth stack.
 */
ssize_t lbt_read_string(struct bt_conn *conn, const struct bt_gatt_attr *attr,
			void *buf, u16_t len, u16_t offset,
			u16_t max_str_length);

/** 
 * @brief Helper function for writing a string characteristic from the 
 * Bluetooth stack.
 * @param max_str_length is the maximum string length of the item.  
 * It is assumed by this function the the actual size of the item is 1 character 
 * longer so that the string can be NULL terminated.
 */
ssize_t lbt_write_string(struct bt_conn *conn, const struct bt_gatt_attr *attr,
			 const void *buf, u16_t len, u16_t offset, u8_t flags,
			 u16_t max_str_length);

/** 
 * @brief Helper function for writing a u8_t from the Bluetooth stack.
 */
ssize_t lbt_write_u8(struct bt_conn *conn, const struct bt_gatt_attr *attr,
		     const void *buf, u16_t len, u16_t offset, u8_t flags);

/**
 * @brief Helper function for finding a characteristic handle in the GATT
 * table.
 */
u16_t lbt_find_gatt_index(struct bt_uuid *uuid, struct bt_gatt_attr *gatt,
			  size_t size);
```

## include/lte.h
```c
/*
 * Copyright (c) 2019 Laird Connectivity
 *
 * SPDX-License-Identifier: Apache-2.0
 */

#ifndef __LTE_H__
#define __LTE_H__

enum lte_errors {
	LTE_ERR_NONE = 0,
	LTE_ERR_NO_IFACE = -1,
	LTE_ERR_IFACE_CFG = -2,
	LTE_ERR_DNS_CFG = -3,
	LTE_ERR_MDM_CTX = -4,
};

enum lte_event { LTE_EVT_READY, LTE_EVT_DISCONNECTED };

struct lte_status {
	const char *radio_version;
	const char *IMEI;
	const char *ICCID;
	const char *serialNumber;
	/* This is actually RSRP (Reference Signals Received Power in dBm)*/
	int rssi;
	/* Signal to Interference plus Noise Ratio (dBm) */
	int sinr;
};

/* Callback function for LTE events */
typedef void (*lte_event_function_t)(enum lte_event event);

void lteRegisterEventCallback(lte_event_function_t callback);
int lteInit(void);
bool lteIsReady(void);
struct lte_status *lteGetStatus(void);

#endif
```

## include/nv.h
```c
/*
 * Copyright (c) 2019 Laird Connectivity
 *
 * SPDX-License-Identifier: Apache-2.0
 */

#ifndef NV_H
#define NV_H

#define NV_FLASH_DEVICE DT_FLASH_DEV_NAME
#define NV_FLASH_OFFSET DT_FLASH_AREA_STORAGE_OFFSET

#define NUM_FLASH_SECTORS 4

int nvInit(void);
int nvReadCommissioned(bool *commissioned);
int nvStoreCommissioned(bool commissioned);
int nvStoreDevCert(u8_t *cert, u16_t size);
int nvStoreDevKey(u8_t *key, u16_t size);
int nvReadDevCert(u8_t *cert, u16_t size);
int nvReadDevKey(u8_t *key, u16_t size);
int nvDeleteDevCert(void);
int nvDeleteDevKey(void);
int nvStoreAwsEndpoint(u8_t *ep, u16_t size);
int nvReadAwsEndpoint(u8_t *ep, u16_t size);
int nvDeleteAwsEndpoint(void);
int nvStoreAwsClientId(u8_t *id, u16_t size);
int nvReadAwsClientId(u8_t *id, u16_t size);
int nvDeleteAwsClientId(void);
int nvStoreAwsRootCa(u8_t *cert, u16_t size);
int nvReadAwsRootCa(u8_t *cert, u16_t size);
int nvDeleteAwsRootCa(void);

#endif
```

## include/oob_ble.h
```c
/*
 * Copyright (c) 2019 Laird Connectivity
 *
 * SPDX-License-Identifier: Apache-2.0
 */

#ifndef __OOB_BLE_H__
#define __OOB_BLE_H__

#include <bluetooth/bluetooth.h>
#include <bluetooth/hci.h>
#include <bluetooth/conn.h>
#include <bluetooth/uuid.h>
#include <bluetooth/gatt.h>
#include <misc/byteorder.h>

/* Callback function for passing sensor data */
typedef void (*sensor_updated_function_t)(u8_t sensor, s32_t reading);

/* Function for initialising the BLE portion of the OOB demo */
void oob_ble_initialise(const char *imei);

/* Function for setting the sensor read callback function */
void oob_ble_set_callback(sensor_updated_function_t func);

struct bt_conn *oob_ble_get_central_connection(void);

#endif /* __OOB_BLE_H__ */
```

## include/oob_common.h
```c
/*
 * Copyright (c) 2019 Laird Connectivity
 *
 * SPDX-License-Identifier: Apache-2.0
 */

#include <stdint.h>

#define APP_VERSION_MAJOR 0
#define APP_VERSION_MINOR 8
#define APP_VERSION_PATCH 0
#define APP_VERSION_STRING                                                     \
	STRINGIFY(APP_VERSION_MAJOR)                                           \
	"." STRINGIFY(APP_VERSION_MINOR) "." STRINGIFY(APP_VERSION_PATCH)

#define DATA_SEND_TIME_SECONDS 30

#define RETRY_AWS_ACTION_TIMEOUT_SECONDS 30

#define DEFAULT_LED_ON_TIME_FOR_1_SECOND_BLINK K_MSEC(100)
#define DEFAULT_LED_OFF_TIME_FOR_1_SECOND_BLINK K_MSEC(900)

#define SHA256_SIZE 32

enum SENSOR_TYPES {
	SENSOR_TYPE_TEMPERATURE = 0,
	SENSOR_TYPE_HUMIDITY,
	SENSOR_TYPE_PRESSURE,
	SENSOR_TYPE_DEW_POINT,

	SENSOR_TYPE_MAX
};

enum CREDENTIAL_TYPE { CREDENTIAL_CERT, CREDENTIAL_KEY };

enum APP_ERROR {
	APP_ERR_NOT_READY = -1,
	APP_ERR_COMMISSION_DISALLOWED = -2,
	APP_ERR_CRED_TOO_LARGE = -3,
	APP_ERR_UNKNOWN_CRED = -4,
	APP_ERR_READ_CERT = -5,
	APP_ERR_READ_KEY = -6,
};

typedef void (*app_state_function_t)(void);

void strncpy_replace_underscore_with_space(char *restrict s1,
					   const char *restrict s2,
					   size_t size);
```

## include/power.h
```c
/*
 * Copyright (c) 2020 Laird Connectivity
 *
 * SPDX-License-Identifier: Apache-2.0
 */
#ifndef POWER_H
#define POWER_H

//=============================================================================
// Includes
//=============================================================================

#include <zephyr/types.h>

//=============================================================================
// Board definitions
//=============================================================================

/* Port and pin number of the voltage measurement enabling functionality */
#define MEASURE_ENABLE_PORT		DT_NORDIC_NRF_GPIO_0_LABEL
#define MEASURE_ENABLE_PIN		28

/* Measurement time between readings */
#define POWER_TIMER_PERIOD		K_MSEC(15000)

/* Reboot types */
#define REBOOT_TYPE_NORMAL		0
#define REBOOT_TYPE_BOOTLOADER		1

//=============================================================================
// Global Function Prototypes
//=============================================================================

/**
 * @brief Init the power measuring system
 */
void power_init(void);

/**
 * @brief Enables or disables the power measurement system
 * @param true to enable, false to disable
 */
void power_mode_set(bool enable);

#ifdef CONFIG_REBOOT
/**
 * @brief Reboots the module
 * @param 0 = normal reboot, 1 = stay in UART bootloader
 */
void power_reboot_module(u8_t type);
#endif

#endif /* POWER_H */
```
