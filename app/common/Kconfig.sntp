## app/common/Kconfig.sntp
```kconfig
# Copyright (c) 2021 Laird Connectivity
# SPDX-License-Identifier: Apache-2.0

menu "SNTP settings"

if SNTP

config SNTP_TIMEOUT_MILLISECONDS
    int "SNTP timeout in milliseconds"
    range 300 1200000
    default 1000
    help
        Timeout value in milliseconds if the SNTP time request should be
        aborted if it was not sucessfully retrieved from the server.

config SNTP_SYNCRONISATION_DELAY_SECONDS
    int "Delay in seconds before querying SNTP server"
    range 1 60
    default 5
    help
        This allows the network connectivity to settle before an
        attempt is made to query the SNTP server and applies when the
        network is brought online or recovers from being down.

config SNTP_RESYNCRONISATION_SECONDS
    int "Delay in seconds after successful query before resyncronisation"
    range 1 108000
    default 3600
    help
        Time between resyncronising the module's time with the SNTP
        server's time to prevent clock drift, applies after a
        successful SNTP syncronisation.

config SNTP_ERROR_SYNCRONISATION_SECONDS
    int "Delay in seconds after failed query before attempting again"
    range 1 108000
    default 30
    help
        Time between re-trying to retrieve the time from the SNTP
        server after it has failed.

config SNTP_ERROR_ATTEMPTS
    int "Number of failed attempts to syncronise before delaying"
    range 0 60
    default 5
    help
        Number of attempts trying to retrieve the time from the SNTP
        server which have failed before waiting for
        SNTP_RESYNCRONISATION_SECONDS before retrying to allow the
        network connectivity issue to recover (0 will disable this
        check and continue indefinitely without a longer pause).

config SNTP_THREAD_PRIORITY
    int "SNTP thread priority"
    default 5

config SNTP_THREAD_STACK_SIZE
    int "SNTP thread stack size in bytes"
    default 2048

config LCZ_SNTP_SHELL
    bool "Enable shell commands"
    default y
    depends on SHELL

endif # SNTP

endmenu
```

## app/common/Kconfig.wdt
```kconfig
# Copyright (c) 2021 Laird Connectivity
# SPDX-License-Identifier: Apache-2.0

menuconfig WDT
    bool "Config Watchdog Timer"
    imply WATCHDOG
    help
        Enable-to-Disable requires power cycle or watchdog reset.
        Watchdog cannot be stopped once started.
        It can be reconfigured after a reset.
        If a watchdog reset occurs, then it won't cause another
        reset unless it is re-enabled.

if WDT

config WDT_INIT_PRIORITY
    int "System init priority (Application)"
    default 0

config WDT_LOG_LEVEL
    int "Log level for BLE watchdog module"
    range 0 4
    default 3

config WDT_TIMEOUT_MILLISECONDS
    int "Rate in milliseconds for watchdog"
    range 18000 1200000
    default 600000
    help
        The bootloader (mcuboot) supplied with the application prior to
        4.0.0 doesn't feed the watchdog. If the bootloader hasn't been
        updated (requires a physical connection), the timeout should
        remain at 10 minutes.

config WDT_MEMFAULT_PRE_FIRE_MS
    int "The software timer fires before the HW WDT"
    default 8000
    help
        This software timer is used to save a core dump before reset.
        This must be large enough so that the system can reboot and
        feed the dog. The memfault software watchdog causes a
        reset assertion.  The kernel with modem requires 3 seconds
        to boot.

config WDT_WORK_QUEUE_STACK_SIZE
    int
    default 320

config WDT_TEST
    bool "Force the watchdog to timeout (set during initialization)"

endif # WDT
```

## app/contact_tracing/Kconfig
```kconfig
# Copyright (c) 2021 Laird Connectivity
# SPDX-License-Identifier: Apache-2.0

menuconfig CONTACT_TRACING
    bool "Config Contact Tracing"
    depends on BLUEGRASS
    depends on MCUMGR
    depends on MCUMGR_CMD_FS_MGMT
    depends on MCUMGR_SMP_BT
    depends on !LWM2M
    depends on !SCAN_FOR_BT510
    depends on !BL654_SENSOR
    depends on !SINGLE_PERIPHERAL
    depends on SHELL_BACKEND_DUMMY
    select BLE_SENSOR_SERVICE
    select CRYPTO
    select CRYPTO_TINYCRYPT_SHIM

if CONTACT_TRACING

config CT_AWS_PUBLISH_ENTRIES
    bool "Publish each CT Entry to AWS"
    default y

config CT_AWS_DUMMY_ENTRY_SIZE
    int
    default 24

config SCAN_FOR_BT510_CT
    bool "Parse Bluetooth advertisements for BT510 CT Sensor"
    default y

config CT_BLE_LOG_LEVEL
    int "Log level for BLE contact tracing module"
    range 0 4
    default 3

config CT_DEBUG_SMP_TRANSFERS
    bool "Extra debug print statements for SMP transfers"
    depends on CT_BLE_LOG_LEVEL = 4

config CT_VERBOSE
    bool "Verbose debug print statements (mostly SMP transfers)"
    depends on CT_BLE_LOG_LEVEL = 4

config CT_SHELL
    bool "Enable contact tracing shell"
    depends on SHELL
    default y

config CT_BLE_LOG_LEVEL
    int "Contact Tracing BLE Module Log level"
    range 0 4
    default 3

config CT_APP_LOG_LEVEL
    int "Contact Tracing App module Log level"
    range 0 4
    default 3

config CT_APP_TICK_RATE_SECONDS
    int "Tick rate for Contact Tracing app module"
    default 1
    help
        Controls watchdog, AWS CT log publisher, and SD Log publisher.

config CT_APP_SD_CARD_LOG_PUBLISH_RATE_SECONDS
    int "Publish rate for SD Card log"
    default 5

config CT_ADV_WATCHDOG_SECONDS
    int "Maximum amount of time that is allowed for not receiving adverts before reset"
    default 3600
    help
        Disabled when 0

config CT_ADV_LOG_FILTER_CNT
    int "After this many advertisements are seen a debug message will be printed"
    depends on CT_BLE_LOG_LEVEL >= 3
    default 1000

config CT_CONN_INACTIVITY_TICK_RATE_SECONDS
    int "Tick rate for sensor inactivity check"
    default 60
    help
        Disabled when 0

config CT_CONN_INACTIVITY_WATCHDOG_TIMEOUT
    int "Number of seconds of inactivity required to disconnect CT sensor"
    default 120

config CT_CONNECTABLE_ADV_DURATION_SECONDS
    int "Duration to advertise as connectable when button is pressed"
    default 30
    help
        Disabled when 0 (always advertise as connectable)

config CT_AD_RATE_MS
    int "Contact tracing advertisement rate"
    range 100 10000
    default 1000
    help
        Default is to update advert every second to keep epoch time up to date

config CT_FS_INTERCEPT_LOG_LEVEL
    int "Contact Tracing File System Intercept module log level"
    range 0 4
    default 3

config CT_AWS_BUF_SIZE
    int "Size of the buffer for sending to AWS"
    default 2048

config CT_LOG_DOWNLOAD_BUFFER_SIZE
    int "Size of the buffer used to hold logs downloaded from Contact Tracing sensors"
    default 1152

#define LOG_DOWNLOAD_BUFFER_SIZE 1152


endif # CONTACT_TRACING
```

## app/ess_sensor/Kconfig
```kconfig
# Copyright (c) 2021 Laird Connectivity
# SPDX-License-Identifier: Apache-2.0

menuconfig ESS_SENSOR
    bool "ESS (BL654 sensor board) support"

if ESS_SENSOR

config ESS_SENSOR_LOG_LEVEL
    int "Log level for ESS module"
    range 0 4
    default 3

config ESS_SENSOR_SEND_TO_AWS_RATE_SECONDS
    int "The period at which to send ESS device data to AWS"
    default 60
    range 30 3600

config ESS_SENSOR_LEGACY_BL654_SENSOR_NAME
    string "Advertised name of the (legacy) BL654 sensor board"
    default "BL654 BME280 Sensor"
    help
        The Pinnacle 100 development kit ships with a BL654 sensor board
        which has an ESS (environmental sensing service) application
        running on it, due to a bug in the code, it does not advertise
        the service UUIDs and therefore scanning for this device must be
        based on the name of the sensor, configured here. This is not
        required if using the Zephyr-based ESS sample code which
        advertises with the ESS UUID.

endif # ESS_SENSOR
```

## app/http_fota/Kconfig
```kconfig
# Copyright (c) 2021 Laird Connectivity
# SPDX-License-Identifier: Apache-2.0

config HTTP_FOTA
    bool "enable FOTA over HTTP"
    depends on DNS_RESOLVER
    depends on NET_SOCKETS
    depends on BOOTLOADER_MCUBOOT
    select DOWNLOAD_CLIENT
    select FOTA_DOWNLOAD
    select DFU_TARGET
    select IMG_MANAGER
    select IMG_ERASE_PROGRESSIVELY

if HTTP_FOTA

config HTTP_FOTA_TASK_PRIO
    int "Thread priority"
    default 2
    help
      Pre-emptive thread priority

config HTTP_FOTA_TASK_STACK_SIZE
    int "Thread stack size"
    default 4096

config HTTP_FOTA_TASK_LOG_LEVEL
	int "task log level"
	default 4
	range 0 4

config HTTP_FOTA_TASK_QUEUE_DEPTH
    int "Task queue depth"
    default 4

config HTTP_FOTA_ERROR_DELAY
    int "Seconds to wait before trying again after and error occurs."
    default 60
    help
        This allows time for the shadow to be updated.

config HTTP_FOTA_MODEM_INSTALL_DELAY
    int "Seconds to wait to allow modem to install update"
    depends on MODEM_HL7800
    default 600
    help
        Used to prevent starting duplicate update cycle while the modem reboots by
        keeping cloud state machine in FOTA state until modem has rebooted.

config HTTP_FOTA_DELETE_FILE_AFTER_UPDATE
    depends on MODEM_HL7800
    bool "Delete HL7800 update file after update"
    default y

endif # HTTP_FOTA
```

## app/lwm2m/Kconfig
```kconfig
# Copyright (c) 2021 Laird Connectivity
# SPDX-License-Identifier: Apache-2.0

menuconfig LCZ_LWM2M
    bool "Laird Connectivity LWM2M Demo Options"
    depends on LWM2M
    depends on LCZ_QRTC
    depends on LCZ_SOFTWARE_RESET
    depends on !MODEM_HL7800 || MODEM_HL7800_BOOT_NORMAL
    depends on ATTR
    depends on FILE_SYSTEM_UTILITIES

if LCZ_LWM2M

config LWM2M_PATH_MAX_SIZE
    int
    default 25
    help
        The max path is "/65535/65535/65535/65535"

config LWM2M_PSK_TAG
    int "Tag used by TLS for referencing PSK"
    depends on LWM2M_DTLS_SUPPORT
    default 3
    help
        Must be unique in the system.

config LCZ_LWM2M_LOG_LEVEL
    int "LwM2M Client log Level"
    range 0 4
    default 3

config LCZ_LWM2M_MAX_LOAD_SIZE
    int "Maximum size of resource config/data stored in nv"
    default 8

menuconfig LCZ_LWM2M_SENSOR
    bool "Enable module that processes BT510/BT6xx advertisements"

if LCZ_LWM2M_SENSOR

config LCZ_LWM2M_SENSOR_LOG_LEVEL
    int "LwM2M sensor module log level"
    depends on LCZ_LWM2M_SENSOR
    range 0 4
    default 3

config LCZ_LWM2M_SENSOR_MAX
    int "Maximum number of sensors in table"
    default LWM2M_GATEWAY_MAX_INSTANCES

config LCZ_LWM2M_SENSOR_ADD_PREFIX_TO_BDA
    bool "Add Bluetooth device address to gateway prefix resource"

config LCZ_LWM2M_SENSOR_ALLOW_BT510
    bool "Enable processing of BT510 temperature advertisements"
    help
        Default is to process BT610 ads.

endif # LCZ_LWM2M_SENSOR

config LCZ_LWM2M_FW_UPDATE
    bool "Enable LwM2M firmware updates that work with mcuboot"
    select DFU_TARGET
    select IMG_ERASE_PROGRESSIVELY
    depends on LWM2M_FIRMWARE_UPDATE_OBJ_SUPPORT
    depends on BOOTLOADER_MCUBOOT

if LCZ_LWM2M_FW_UPDATE

config LCZ_LWM2M_FW_UPDATE_LOG_LEVEL
    int "LwM2M firmware update log level"
    range 0 4
    default 3

config LCZ_LWM2M_FW_UPDATE_MCUBOOT_FLASH_BUF_SIZE
	int "Flash write buffer size during MCUboot updates"
	default 512
	help
	  Buffer size must be aligned to the minimal flash write block size.

endif # LCZ_LWM2M_FW_UPDATE

config LCZ_LWM2M_CONN_MON
    bool "Enable LwM2M connectivity monitoring object"
    depends on LWM2M_CONN_MON_OBJ_SUPPORT

config LCZ_LWM2M_CONN_MON_LEVEL
    int "LwM2M sensor module log level"
    depends on LCZ_LWM2M_CONN_MON
    range 0 4
    default 3

config LCZ_LWM2M_MEMFAULT_TASK
    bool "Enable Memfault task"
    depends on LCZ_MEMFAULT
    default y
    help
      Enable Memfault task for periodically reporting Memfault data.

if LCZ_LWM2M_MEMFAULT_TASK

config LCZ_LWM2M_MEMFAULT_THREAD_PRIORITY
	int "Preemptible thread priority"
	range 0 NUM_PREEMPT_PRIORITIES
	default 1

config LCZ_LWM2M_MEMFAULT_THREAD_STACK_SIZE
	int "Stack size"
	default 3072

config LCZ_LWM2M_MEMFAULT_REPORT_PERIOD_SECONDS
	int "Report period"
	default 3600
	help
	  How often to periodically push memfault data (in seconds)

config LCZ_LWM2M_MEMFAULT_CHUNK_BUF_SIZE
	int "Chunk buffer size"
	default 1024
	help
	  Size of the buffer used to post/save memfault data

endif # LCZ_LWM2M_MEMFAULT_TASK

endif # LCZ_LWM2M
```

## west.yml
```yaml
# The west manifest file for Pinnacle 100.
#
# The per-installation west configuration file, .west/config, sets the
# path to the project containing this file in the [manifest] section's
# "path" variable.
#
# You are free to create your own manifest files and put them in any
# repository you want, to create your own custom Zephyr installations.
# For example, you could create a manifest file in your own out of
# tree application directory, which would pull this zephyr repository
# in as an ordinary project.
#
# You can pass your manifest repositories to west init when creating a
# new Zephyr installation. See the west documentation for more
# information.

manifest:
  remotes:
    - name: LairdCP
      url-base: https://github.com/LairdCP
    - name: LairdInternal
      url-base: git@git.devops.rfpros.com:/cp_cellular
    - name: zephyrproject
      url-base: https://github.com/zephyrproject-rtos
    - name: jsmnRepo
      url-base: https://github.com/zserge
    - name: prodEng
      url-base: git@git.devops.rfpros.com:prod_eng

  # Please add items below based on alphabetical order
  # Many of these dependencies we taken from the default Zephyr west manifest.
  # These dependencies may need updating if new features are added to the firmware.
  projects:
    - name: zephyr
      repo-path: zephyr.git
      west-commands: scripts/west-commands.yml
      revision: c0a5d5f1521e2a2710032ac71bffbe88f0b82cca
      remote: LairdInternal
    - name: lairdconnectivityhal
      repo-path: zephyr-hal-lairdconnectivity.git
      path: zephyr/ext/hal/lairdconnectivity
      revision: ae68879a75c1955000e2d7a810b066f40295a946
      remote: LairdInternal
    - name: zephyr_boards
      path: zephyr/boards/arm
      revision: de9470f2516837cd17e9da7ac850455deb5c411f
      remote: prodEng
    - name: jsmn
      repo-path: jsmn.git
      path: modules/jsmn
      revision: 7b6858a5855299d173c5ab2b46e611bf9961cbef
      remote: jsmnRepo
    - name: framework
      repo-path: framework_zephyr.git
      path: modules/framework
      revision: 986809c6e5d629c3d163806823e02694d569b3b8
      remote: prodEng

  self:
    path: mg100
```
