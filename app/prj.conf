## CMakeLists.txt
```
cmake_minimum_required(VERSION 3.13.1)

set(lcz_module_path ${CMAKE_SOURCE_DIR}/../../modules/lib/laird_connect)

if (CONFIG_LWM2M)
list(APPEND OVERLAY_CONFIG
    ${CMAKE_SOURCE_DIR}/overlay_lwm2m_dtls.conf
)
endif()

# Add configuration for building with mcuboot
# because it cannot be done with relative paths in VS code on Windows
if((BOARD STREQUAL mg100) OR (BOARD STREQUAL pinnacle_100_dvk))
set(mcuboot_CONF_FILE
    ${lcz_module_path}/zephyr_lib/mcuboot_config/pinnacle_100.conf
)

if (CONFIG_LWM2M)
list(APPEND OVERLAY_CONFIG
    ${CMAKE_SOURCE_DIR}/overlay_lwm2m_pinnacle_100.conf
)
endif()

elseif((BOARD STREQUAL bl5340_dvk_cpuapp) OR (BOARD STREQUAL bl5340pa_dvk_cpuapp))
set(mcuboot_CONF_FILE
    ${lcz_module_path}/zephyr_lib/mcuboot_config/bl5340.conf
)
endif()

list(APPEND OVERLAY_CONFIG
    ${lcz_module_path}/zephyr_lib/mcumgr_wrapper/config/overlay-mcuboot.conf
)

# Use static partition layout for board
set(PM_STATIC_YML_FILE
    ${lcz_module_path}/zephyr_lib/mcuboot_config/pm_static.${BOARD}.yml
)

# Generate build ID based on UTC timestamp
string(TIMESTAMP build_time "%s" UTC)
set(APP_VERSION_BUILD ${build_time})
set(gen_dir ${CMAKE_BINARY_DIR}/zephyr/include/generated/app)
set(ver_file ${gen_dir}/app_version.h)
configure_file(${CMAKE_SOURCE_DIR}/version/app_version.h.in ${ver_file})
# Get application version
file(READ ${ver_file} ver)
string(REGEX MATCH "APP_VERSION_MAJOR ([0-9]+)" _ ${ver})
set(ver_major ${CMAKE_MATCH_1})
string(REGEX MATCH "APP_VERSION_MINOR ([0-9]+)" _ ${ver})
set(ver_minor ${CMAKE_MATCH_1})
string(REGEX MATCH "APP_VERSION_PATCH ([0-9]+)" _ ${ver})
set(ver_patch ${CMAKE_MATCH_1})
set(app_version ${ver_major}.${ver_minor}.${ver_patch}+${build_time})
message("app version: ${app_version}")

# Set application version for mcuboot
set(mcuboot_ver_conf ${CMAKE_BINARY_DIR}/generated_app_version.conf)
set(APP_IMAGE_VERSION ${app_version})
set(MEMFAULT_APP_VERSION ${ver_major}.${ver_minor}.${ver_patch})
configure_file(${CMAKE_SOURCE_DIR}/version/app_version.conf.in ${mcuboot_ver_conf})

# Prepend the additional boards directory but still allow the original Zephyr
# boards directory to be used with lower priority
list(PREPEND BOARD_ROOT ${CMAKE_CURRENT_LIST_DIR}/../../)

find_package(Zephyr REQUIRED HINTS $ENV{ZEPHYR_BASE})
project(oob_demo)

if(CONFIG_LCZ_MEMFAULT)
zephyr_include_directories(${CMAKE_SOURCE_DIR}/memfault)
if((BOARD STREQUAL mg100) OR (BOARD STREQUAL pinnacle_100_dvk))
zephyr_include_directories(${CMAKE_SOURCE_DIR}/memfault/mg100)
elseif((BOARD STREQUAL bl5340_dvk_cpuapp) OR (BOARD STREQUAL bl5340pa_dvk_cpuapp))
zephyr_include_directories(${CMAKE_SOURCE_DIR}/memfault/bl5340)
endif()
endif()

target_sources(app PRIVATE
    ${CMAKE_SOURCE_DIR}/common/src/main.c
    ${CMAKE_SOURCE_DIR}/common/src/jsmn_json.c
    ${CMAKE_SOURCE_DIR}/common/src/button.c
    ${CMAKE_SOURCE_DIR}/common/src/ble.c
    ${CMAKE_SOURCE_DIR}/common/src/lcz_certs.c
    ${CMAKE_SOURCE_DIR}/common/src/gateway_common.c
    ${CMAKE_SOURCE_DIR}/common/src/control_task.c
    ${CMAKE_SOURCE_DIR}/common/src/gateway_fsm.c
    ${CMAKE_SOURCE_DIR}/common/src/fota_smp.c
)

target_sources_ifdef(CONFIG_MODEM_HL7800 app PRIVATE
    ${CMAKE_SOURCE_DIR}/common/src/lte.c
)

target_sources_ifdef(CONFIG_NET_L2_ETHERNET app PRIVATE
    ${CMAKE_SOURCE_DIR}/common/src/ethernet_network.c
)

target_sources_ifdef(CONFIG_SNTP app PRIVATE
    ${CMAKE_SOURCE_DIR}/common/src/sntp_qrtc.c
)

target_sources_ifdef(CONFIG_LCZ_SNTP_SHELL app PRIVATE
    ${CMAKE_SOURCE_DIR}/common/src/lcz_sntp_shell.c
)

if(CONFIG_DISPLAY)
include_directories(${CMAKE_SOURCE_DIR}/display/include)
target_sources(app PRIVATE
    ${CMAKE_SOURCE_DIR}/display/src/lcd.c
)

# BL5340 has 1 image, BL5340PA has 2 images
target_sources_ifdef(CONFIG_BOARD_BL5340_DVK_CPUAPP app PRIVATE
    ${CMAKE_SOURCE_DIR}/display/src/bl5340_module.c
)
target_sources_ifdef(CONFIG_BOARD_BL5340PA_DVK_CPUAPP app PRIVATE
    ${CMAKE_SOURCE_DIR}/display/src/bl5340pa_module_ext.c
    ${CMAKE_SOURCE_DIR}/display/src/bl5340pa_module_int.c
)
endif()

if(CONFIG_CONTACT_TRACING)
zephyr_include_directories(${CMAKE_SOURCE_DIR}/contact_tracing/include)
target_sources(app PRIVATE
    ${CMAKE_SOURCE_DIR}/contact_tracing/src/ct_ble.c
    ${CMAKE_SOURCE_DIR}/contact_tracing/src/ct_app.c
    ${CMAKE_SOURCE_DIR}/contact_tracing/src/rpc_params.c
    ${CMAKE_SOURCE_DIR}/contact_tracing/src/dfu_smp_c.c
    ${CMAKE_SOURCE_DIR}/contact_tracing/src/lcz_fs_mgmt_intercept.c
)
endif()

target_sources_ifdef(CONFIG_CT_SHELL app PRIVATE
    ${CMAKE_SOURCE_DIR}/contact_tracing/src/ct_shell.c
)

target_sources_ifdef(CONFIG_SINGLE_PERIPHERAL app PRIVATE
    ${CMAKE_SOURCE_DIR}/common/src/single_peripheral.c
)

target_sources_ifdef(CONFIG_WDT app PRIVATE
    ${CMAKE_SOURCE_DIR}/common/src/wdt.c)

include_directories(${CMAKE_SOURCE_DIR}/common/include)
include_directories(${gen_dir})
include_directories(${CMAKE_SOURCE_DIR}/framework_config)
include_directories(${CMAKE_SOURCE_DIR}/../../modules/lib/jsmn)

if(CONFIG_BOARD_MG100)
target_sources(app PRIVATE
    ${CMAKE_SOURCE_DIR}/common/src/lairdconnect_battery.c
)
endif()

if(CONFIG_SD_CARD_LOG)
target_sources(app PRIVATE
    ${CMAKE_SOURCE_DIR}/common/src/sdcard_log.c
)
endif()

if(CONFIG_LCZ_MOTION)
target_sources(app PRIVATE
    ${CMAKE_SOURCE_DIR}/common/src/lcz_motion.c
)
endif()

if(CONFIG_LCZ_MOTION_TEMPERATURE)
target_sources(app PRIVATE
    ${CMAKE_SOURCE_DIR}/common/src/lcz_motion_temperature.c
)
endif()

if(CONFIG_LCZ_LWM2M)
include_directories(${CMAKE_SOURCE_DIR}/lwm2m/include)
target_sources(app PRIVATE
    ${CMAKE_SOURCE_DIR}/lwm2m/source/lcz_lwm2m_client.c
)
if(CONFIG_LCZ_LWM2M_MEMFAULT_TASK)
target_sources(app PRIVATE
    ${CMAKE_SOURCE_DIR}/lwm2m/source/memfault_task.c
)
endif()
endif()

if(CONFIG_LCZ_LWM2M_SENSOR)
target_sources(app PRIVATE
    ${CMAKE_SOURCE_DIR}/lwm2m/source/lcz_lwm2m_gateway.c
    ${CMAKE_SOURCE_DIR}/lwm2m/source/lcz_lwm2m_sensor.c
)
endif()

if(CONFIG_LCZ_LWM2M_FW_UPDATE)
target_sources(app PRIVATE
    ${CMAKE_SOURCE_DIR}/lwm2m/source/lcz_lwm2m_fw_update.c
)
endif()

if(CONFIG_LCZ_LWM2M_CONN_MON)
target_sources(app PRIVATE
    ${CMAKE_SOURCE_DIR}/lwm2m/source/lcz_lwm2m_conn_mon.c
)
endif()

if(CONFIG_LWM2M_UCIFI_BATTERY)
target_sources(app PRIVATE
    ${CMAKE_SOURCE_DIR}/lwm2m/source/lcz_lwm2m_battery.c
)
endif()

if(CONFIG_BLUEGRASS)
include_directories(${CMAKE_SOURCE_DIR}/bluegrass/include)
target_sources(app PRIVATE
    ${CMAKE_SOURCE_DIR}/bluegrass/source/bluegrass.c
    ${CMAKE_SOURCE_DIR}/bluegrass/source/sensor_cmd.c
    ${CMAKE_SOURCE_DIR}/bluegrass/source/sensor_gateway_parser.c
    ${CMAKE_SOURCE_DIR}/bluegrass/source/shadow_builder.c
    ${CMAKE_SOURCE_DIR}/bluegrass/source/to_string.c
    ${CMAKE_SOURCE_DIR}/common/src/aws.c
)
endif()

if(CONFIG_SENSOR_TASK)
target_sources(app PRIVATE
    ${CMAKE_SOURCE_DIR}/bluegrass/source/sensor_log.c
    ${CMAKE_SOURCE_DIR}/bluegrass/source/sensor_table.c
    ${CMAKE_SOURCE_DIR}/bluegrass/source/sensor_task.c
)
endif()

if(CONFIG_ESS_SENSOR)
include_directories(${CMAKE_SOURCE_DIR}/ess_sensor/include)
target_sources(app PRIVATE ${CMAKE_SOURCE_DIR}/ess_sensor/source/ess_sensor.c)
endif()

if (CONFIG_COAP_FOTA)
include_directories(${CMAKE_SOURCE_DIR}/coap/include)
target_sources(app PRIVATE
    ${CMAKE_SOURCE_DIR}/coap/source/coap_fota_json_parser.c
    ${CMAKE_SOURCE_DIR}/coap/source/coap_fota.c
    ${CMAKE_SOURCE_DIR}/coap/source/coap_fota_shadow.c
    ${CMAKE_SOURCE_DIR}/coap/source/coap_fota_task.c
)
endif() # CONFIG_COAP_FOTA

if (CONFIG_HTTP_FOTA)
include_directories(${CMAKE_SOURCE_DIR}/http_fota/include)
target_sources(app PRIVATE
    ${CMAKE_SOURCE_DIR}/http_fota/source/http_fota_task.c
    ${CMAKE_SOURCE_DIR}/http_fota/source/http_fota_shadow.c
)
target_sources_ifdef(CONFIG_MODEM_HL7800 app PRIVATE
    ${CMAKE_SOURCE_DIR}/http_fota/source/hl7800_http_fota.c
)
endif() # CONFIG_HTTP_FOTA

if(CONFIG_SHELL AND CONFIG_MODEM_HL7800)
target_sources(app PRIVATE
    ${CMAKE_SOURCE_DIR}/common/src/lcz_modem_shell.c
)
endif()
```

## Kconfig
```
# Copyright (c) 2021 Laird Connectivity
# SPDX-License-Identifier: Apache-2.0

menuconfig USER_APPLICATION
     bool "Config User Application"
	 default y

if USER_APPLICATION

config LAIRD_CONNECTIVITY_DEBUG
    bool
    default n

config SENSOR_MAX_AD_SIZE
    int "The maximum size for ads sent to sensor task"
    default 67
    help
        67 - BT510 coded PHY advertisement
        31 - BT510 1M PHY advertisement and scan response

config SENSOR_TASK
    bool
    default n

config SCAN_FOR_BT510
    bool "Parse Bluetooth advertisements for BT510 Sensor"
    depends on BT_OBSERVER
    select SENSOR_TASK
    select BLE_VSP_DEFINITIONS

config SCAN_FOR_BT510_CODED
    bool "Scan for coded PHY and 1M advertisements from BT510"
    default y if SCAN_FOR_BT510
    depends on BT_EXT_ADV
    depends on BT_OBSERVER

menuconfig BLUEGRASS
    bool "Laird Connectivity Bluegrass cloud"
    depends on MQTT_LIB
    depends on AWS
    help
        Send sensor data to Bluegrass cloud platform

if BLUEGRASS

config BLUEGRASS_HEARTBEAT_SECONDS
    int "Rate at which to send LTE info and battery status"
    default 120

config USE_SINGLE_AWS_TOPIC
    bool "Send all sensor data to gateway topic"
    help
        PSM mode doesn't easily support receiving information from the
        Laird Connectivity Cloud demo.
        When using a single topic [BT510] temperature data is sent to
        the gateway's topic vs. the individual sensor topic.
        BL654 (ESS) sensor data is always sent to the gateway topic.

config BLUEGRASS_CLEAR_SHADOW_ON_STARTUP
    bool "Null shadow state on first connection"

config JSON_BRACKET_BUFFER_SIZE
    int "The maximum size JSON message that can be processed"
    default 1536
    help
        This applies to sensor messages received over Bluetooth.

config SENSOR_TOPIC_FMT_STR_PREFIX
	string "Default location for sensor data"
	default "$aws/things/%s/shadow"
    help
        "%s will be replaced by the sensor BT address"

config SENSOR_TABLE_SIZE
    int "Number of sensors viewable on Bluegrass gateway page"
    default 5
    range 0 5

config SENSOR_GREENLIST_SIZE
    int "Number of sensors enabled for config and data collection"
    default 3
    range 0 3

config SENSOR_LOG_MAX_SIZE
    int "The maximum number of stored sensor events"
    default 30
    range 1 30
    help
        Limited by the memory pool (heap) and buffer pool (framework).
        Limited by MQTT or modem.

config SENSOR_SUBSCRIPTION_DELAY_SECONDS
    int "Delay after greenlist before subscription to delta/get topics."
    default 10
    range 6 60
    help
        The server needs time to generate the sensor object.
        When the permissions are changed on AWS a disconnect will occur.

config SENSOR_CONFIG_DELAY_SECONDS
    int "Delay before sensor is configured/dumped after greenlist ack"
    default 10
    range 6 60
    help
        Prevent reading of sensor settings during AWS disconnect that
        occurs when a sensor is enabled in Bluegrass
        (for the first time).

config VSP_TX_ECHO
    bool "Print Virtual Serial Port data transmitted to sensors"
    help
        This occurs in task context because strings can be long

config VSP_RX_ECHO
    bool "Print Virtual Serial Port data received from sensors"
    help
        This occurs in task context because strings can be long

config BLUEGRASS_LOG_LEVEL
    int "Bluegrass Log level"
    range 0 4
    default 3

endif # BLUEGRASS

config SENSOR_TASK_LOG_LEVEL
    int "Sensor Task Log level"
    range 0 4
    default 3

config SENSOR_TABLE_LOG_LEVEL
    int "Sensor Table Log level"
    range 0 4
    default 3

config SD_CARD_LOG_LEVEL
    int "SD Card Log level"
    range 0 4
    default 3

config SENSOR_GATEWAY_PARSER_LOG_LEVEL
    int "Sensor gateway parser log level"
    range 0 4
    default 3

config SD_CARD_LOG
    bool "Enable logging to SD card"
    depends on (BOARD_MG100 || BOARD_BL5340_DVK_CPUAPP || BOARD_BL5340PA_DVK_CPUAPP)
    default y

config CONTROL_TASK_LOG_LEVEL
    int "Log level for control (main) task"
    range 0 4
    default 4

config LOG_LEVEL_PSK_GENERATOR
    int "Log level for PSK generator"
    range 0 4
    default 4

config MIN_POWER_MEASUREMENT_MV
    int "The MG100 only measures battery voltage. It may not be present."
    default 2500

config GATEWAY_LOG_LEVEL
    int "Log level for gateway module"
    range 0 4
    default 4

config GATEWAY_FSM_LOG_LEVEL
    int "Log level for gateway state machine module"
    range 0 4
    default 4

config FOTA_SMP_DELETE_ON_COMPLETE
    bool "Delete file on completion of FOTA"
    default y

config SHADOW_FAUX_DATA_STR_SIZE
    int "Size of string sent as part of heartbeat"
    range 0 3072
    default 0

rsource "./common/Kconfig"
rsource "./coap/Kconfig"
rsource "./contact_tracing/Kconfig"
rsource "./http_fota/Kconfig"
rsource "./ess_sensor/Kconfig"
rsource "./lwm2m/Kconfig"

endif # USER_APPLICATION
```

## Kconfig.ble
```
# Copyright (c) 2021 Laird Connectivity
# SPDX-License-Identifier: Apache-2.0

menuconfig BLE
    bool "Enable BLE module"
    default y if BT

if BLE

config BLE_INIT_PRIORITY
    int "SYS_INIT priority (Application Level) of BLE Enable"
    default 0
    help
        This should be initialized first so that other modules can call Bluetooth functions.

config BLE_LOG_LEVEL
    int "Log level for BLE module"
    range 0 4
    default 3

config BLE_NUMBER_OF_IMEI_DIGITS_TO_USE_IN_DEV_NAME
    int "The number of digits of IMEI that are used in ble device name and advertisement"
    default 7

endif # BLE
```

## Kconfig.button
```
# Copyright (c) 2021 Laird Connectivity
# SPDX-License-Identifier: Apache-2.0

config BUTTON_LOG_LEVEL
    int "Log level for button"
    range 0 4
    default 3
```

## Kconfig.lairdconnect_battery
```
# Copyright (c) 2021 Laird Connectivity
# SPDX-License-Identifier: Apache-2.0

config LAIRD_CONNECT_BATTERY_LOG_LEVEL
    int "Laird Connectivity Battery Module Log level"
    range 0 4
    default 3

config LAIRD_CONNECT_BATTERY_LOGGING
    bool "Enable battery logging to SD card"
    depends on SD_CARD_LOG
```

## prj.conf
```kconfig
# General
CONFIG_MAIN_STACK_SIZE=4096
# The AWS/cloud certs are stored on the heap (5K).
# The parameter file is generated from the heap (2K).
# The sensor log shadow is allocated from heap.
CONFIG_HEAP_MEM_POOL_SIZE=10240
CONFIG_NEWLIB_LIBC=y
CONFIG_NEWLIB_LIBC_FLOAT_PRINTF=y

# Debugging
# Use one of the following two options if debugging with breakpoints
# CONFIG_NO_OPTIMIZATIONS=y
# CONFIG_DEBUG_OPTIMIZATIONS=y

# App
CONFIG_BLUEGRASS=y

CONFIG_HTTP_FOTA=y
CONFIG_FSU_HASH=y
# CONFIG_DOWNLOAD_CLIENT_LOG_LEVEL_DBG=y
CONFIG_FOTA_DOWNLOAD_LOG_LEVEL_DBG=y
CONFIG_DFU_TARGET_LOG_LEVEL_DBG=y
# CONFIG_DOWNLOAD_CLIENT_LOG_HEADERS=y
CONFIG_DOWNLOAD_CLIENT_RANGE_REQUESTS=y
CONFIG_DOWNLOAD_CLIENT_TCP_SOCK_TIMEO_MS=0
CONFIG_DOWNLOAD_CLIENT_BUF_SIZE=1024
CONFIG_DOWNLOAD_CLIENT_STACK_SIZE=4096

# App debug
# CONFIG_VSP_TX_ECHO=y
# CONFIG_VSP_RX_ECHO=y
# CONFIG_JSON_LOG_ENABLED=y
# CONFIG_JSON_LOG_PUBLISH=y
# CONFIG_JSON_LOG_TOPIC=y
# CONFIG_JSON_LOG_MQTT_RX_DATA=y

# Bluetooth
CONFIG_BT=y
CONFIG_BT_GATT_DYNAMIC_DB=y
CONFIG_BT_CTLR_TX_PWR_PLUS_8=y
CONFIG_BT_MAX_CONN=3
CONFIG_BT_CTLR_PHY_2M=y
CONFIG_BT_BUF_ACL_TX_SIZE=251
CONFIG_BT_BUF_ACL_RX_SIZE=257
CONFIG_BT_BUF_EVT_RX_SIZE=255
CONFIG_BT_L2CAP_TX_MTU=247
CONFIG_BT_CTLR_DATA_LENGTH_MAX=251
CONFIG_BT_RX_STACK_SIZE=2048
CONFIG_BT_CTLR_PHY_CODED=y
CONFIG_BT_EXT_ADV=y
# Required to enable callbacks
CONFIG_BT_USER_PHY_UPDATE=y
CONFIG_BT_USER_DATA_LEN_UPDATE=y
# BLE Central settings
CONFIG_BT_CENTRAL=y
CONFIG_BT_GATT_CLIENT=y
# Enable simultaneous advertising and scanning
# (zephyr doesn't allow multiple random addresses)
CONFIG_BT_PRIVACY=n
CONFIG_BT_SCAN_WITH_IDENTITY=y
# The BT510 advertises at a 1-second rate (default of 3 seconds is too short)
CONFIG_BT_CREATE_CONN_TIMEOUT=6
# BLE Peripheral settings
CONFIG_BT_PERIPHERAL=y
CONFIG_BT_DEVICE_NAME_DYNAMIC=y
CONFIG_BT_DEVICE_NAME_GATT_WRITABLE=n
# BLE security
CONFIG_BT_SMP=y
CONFIG_BT_BONDABLE=n
CONFIG_BT_MAX_PAIRED=3
# BLE debug
# CONFIG_BT_DEBUG_LOG=y
# CONFIG_BT_DEBUG_CONN=y
# CONFIG_BT_DEBUG_SMP=y

# NETWORKING
CONFIG_NETWORKING=y
CONFIG_NET_IPV4=y
CONFIG_NET_IPV6=n
CONFIG_NET_MGMT=y
CONFIG_NET_MGMT_EVENT=y
CONFIG_NET_SOCKETS=y
CONFIG_NET_SOCKETS_POSIX_NAMES=y
CONFIG_NET_SOCKETS_NET_MGMT=y
CONFIG_NET_SOCKETS_NET_MGMT_MAX_LISTENERS=3
CONFIG_NET_TCP=y
CONFIG_NET_SHELL=y
CONFIG_NET_BUF_POOL_USAGE=y
CONFIG_NET_UDP=y
CONFIG_NET_CONFIG_SETTINGS=n

# Enable the DNS resolver
CONFIG_DNS_RESOLVER=y
CONFIG_NET_SOCKETS_DNS_TIMEOUT=10000

# MQTT
CONFIG_MQTT_LIB=y
# Security
CONFIG_MQTT_LIB_TLS=y
CONFIG_NET_SOCKETS_SOCKOPT_TLS=y
CONFIG_NET_SOCKETS_ENABLE_DTLS=y
# Must match the number of certs being added with tls_credential_add
CONFIG_TLS_MAX_CREDENTIALS_NUMBER=9
# The maximum number of certs to be used when resolving root of trust on a socket
CONFIG_NET_SOCKETS_TLS_MAX_CREDENTIALS=5
# Maximize check-in rate
CONFIG_MQTT_KEEPALIVE=1200

# TLS configuration
CONFIG_MBEDTLS=y
CONFIG_MBEDTLS_DTLS=y
CONFIG_MBEDTLS_BUILTIN=y
CONFIG_MBEDTLS_ENABLE_HEAP=y
CONFIG_MBEDTLS_HEAP_SIZE=54000
CONFIG_MBEDTLS_SSL_MAX_CONTENT_LEN=8092
CONFIG_MBEDTLS_PEM_CERTIFICATE_FORMAT=y
CONFIG_MBEDTLS_KEY_EXCHANGE_PSK_ENABLED=y
# Use format supported by Californium (CoAP bridge) and AWS.
CONFIG_MBEDTLS_KEY_EXCHANGE_ECDHE_ECDSA_ENABLED=y
CONFIG_MBEDTLS_ECP_ALL_ENABLED=y
CONFIG_MBEDTLS_CIPHER_GCM_ENABLED=y

# JSON used by AWS task
CONFIG_JSON_LIBRARY=y

# Storage
CONFIG_NVS=y
CONFIG_MPU_ALLOW_FLASH_WRITE=y
CONFIG_FLASH=y
CONFIG_FCB=y
CONFIG_FLASH_MAP=y
CONFIG_FLASH_PAGE_LAYOUT=y
CONFIG_FLASH_SHELL=n

# Enable mcumgr to support FOTA
CONFIG_MCUMGR=y
CONFIG_MCUMGR_SMP_SHELL=y
CONFIG_MCUMGR_SMP_SHELL_MTU=1024
CONFIG_MCUMGR_BUF_SIZE=1026
CONFIG_MGMT_CBORATTR_MAX_SIZE=1024
CONFIG_FS_MGMT_UL_CHUNK_SIZE=1024
# Enable the Bluetooth mcumgr transport.
CONFIG_MCUMGR_SMP_BT=y
# Unsupported by application
CONFIG_MCUMGR_SMP_BT_AUTHEN=n

CONFIG_MCUMGR_CMD_IMG_MGMT=y
CONFIG_MCUMGR_CMD_OS_MGMT=y
CONFIG_MCUMGR_CMD_FS_MGMT=y
# Enable large files at the expense of larger CBOR encoding.
CONFIG_FS_MGMT_MAX_FILE_SIZE_4GB=y
# Some command handlers require a large stack.
CONFIG_SYSTEM_WORKQUEUE_STACK_SIZE=4096

# Enable the LittleFS file system.
CONFIG_FILE_SYSTEM=y
CONFIG_FILE_SYSTEM_LITTLEFS=y

# Enable QSPI (MX25R64)
CONFIG_NORDIC_QSPI_NOR=y
CONFIG_NORDIC_QSPI_NOR_FLASH_LAYOUT_PAGE_SIZE=4096
CONFIG_NORDIC_QSPI_NOR_STACK_WRITE_BUFFER_SIZE=16
CONFIG_PM_EXTERNAL_FLASH=y
CONFIG_PM_EXTERNAL_FLASH_DEV_NAME="MX25R64"
CONFIG_PM_EXTERNAL_FLASH_SIZE=0x800000
CONFIG_PM_EXTERNAL_FLASH_BASE=0x0
CONFIG_PM_EXTERNAL_FLASH_SUPPORT_LEGACY=y

# command line shell
CONFIG_SHELL=y
CONFIG_SHELL_HISTORY=n
CONFIG_KERNEL_SHELL=y
CONFIG_FILE_SYSTEM_SHELL=y
CONFIG_LCZ_QRTC_SHELL=y
CONFIG_DEVMEM_SHELL=n

# Log messages
CONFIG_LOG=y
CONFIG_LOG2_MODE_DEFERRED=y
CONFIG_LOG_TIMESTAMP_64BIT=y
CONFIG_LOG_BUFFER_SIZE=2048

# Networking debug
CONFIG_NET_LOG=y
# CONFIG_NET_SOCKETS_LOG_LEVEL_DBG=y
CONFIG_NET_SOCKETS_LOG_LEVEL_ERR=y
CONFIG_MBEDTLS_DEBUG=y
CONFIG_MBEDTLS_DEBUG_LEVEL=1
# CONFIG_MBEDTLS_SHELL=y
# CONFIG_MBEDTLS_MEMORY_DEBUG=y
# CONFIG_NET_MGMT_EVENT_LOG_LEVEL_DBG=y

# Segger debugging tools
# CONFIG_SEGGER_SYSTEMVIEW=y
# CONFIG_USE_SEGGER_RTT=y

# Thread Debug
CONFIG_INIT_STACKS=y
CONFIG_THREAD_ANALYZER=y
CONFIG_THREAD_NAME=y
CONFIG_THREAD_MAX_NAME_LEN=12
#CONFIG_HW_STACK_PROTECTION=y
#CONFIG_STACK_SENTINEL=y
#CONFIG_STACK_CANARIES=y

# ADC for power measurement
CONFIG_ADC=y
CONFIG_ADC_NRFX_SAADC=y

# Allows rebooting in zephyr
CONFIG_REBOOT=y

# FPU used for ESS (BL654 sensor board) readings
CONFIG_FPU=y

# Message Framework
CONFIG_FRAMEWORK=y
CONFIG_FWK_ASSERT_ENABLED=y
CONFIG_BUFFER_POOL_SIZE=8192
CONFIG_BUFFER_POOL_STATS=y
CONFIG_BUFFER_POOL_SHELL=y

CONFIG_SCAN_FOR_BT510=y
CONFIG_ESS_SENSOR=y

# Use the Laird Connectivity Zephyr Library
CONFIG_LCZ=y
CONFIG_LCZ_BT=y
CONFIG_LCZ_SENSOR_ADV_FORMAT=y
CONFIG_LCZ_SENSOR_EVENT=y
CONFIG_LCZ_SENSOR_ADV_MATCH=y
CONFIG_LCZ_AD_FIND=y
CONFIG_LCZ_BT_SCAN=y
CONFIG_LCZ_BT_SCAN_MAX_USERS=3
CONFIG_LCZ_BRACKET=y

CONFIG_LCZ_MCUMGR_WRAPPER=y

CONFIG_LCZ_BLE_DIS=y

CONFIG_FILE_SYSTEM_UTILITIES=y

CONFIG_LCZ_QRTC=y
CONFIG_LCZ_QRTC_SYNC_INTERVAL_SECONDS=3600
CONFIG_LCZ_LED=y
CONFIG_LCZ_DNS=y
CONFIG_LCZ_SOCK=y
CONFIG_LCZ_RESET_ON_EXIT=y

CONFIG_WDT=y

CONFIG_LCZ_PARAM_FILE=y
CONFIG_LCZ_PARAM_FILE_MAX_FILE_LENGTH=2000

CONFIG_ATTR=y
CONFIG_ATTR_BROADCAST=y
CONFIG_ATTR_LOG_LEVEL=4
CONFIG_ATTR_SHELL=y
CONFIG_MCUMGR_CMD_SENTRIUS_MGMT=y
CONFIG_ERRNO_STR=y

CONFIG_LCZ_NFC=y

CONFIG_SINGLE_PERIPHERAL=y

CONFIG_LCZ_SOFTWARE_RESET=y
```

## overlay_lwm2m_dtls.conf
```kconfig
# turn off unused features
CONFIG_MQTT_LIB=n
CONFIG_MQTT_LIB_TLS=n
CONFIG_BLUEGRASS=n
CONFIG_SCAN_FOR_BT510=n
CONFIG_COAP_FOTA_BASE64=n
CONFIG_HTTP_FOTA=n

CONFIG_HEAP_MEM_POOL_SIZE=8192

CONFIG_NET_PKT_RX_COUNT=10
CONFIG_NET_PKT_TX_COUNT=10
CONFIG_NET_BUF_RX_COUNT=48
CONFIG_NET_BUF_TX_COUNT=10
CONFIG_NET_MAX_CONTEXTS=5
CONFIG_NET_SOCKETS_TLS_MAX_CONTEXTS=2

CONFIG_DNS_NUM_CONCUR_QUERIES=2
CONFIG_DNS_RESOLVER_AI_MAX_ENTRIES=4

CONFIG_LWM2M=y
#CONFIG_LWM2M_LOG_LEVEL_DBG=y
# Enabling of the bootstrap procedure is also controlled
# by an attribute that is checked during initialization.
CONFIG_LWM2M_RD_CLIENT_SUPPORT_BOOTSTRAP=y
# Largest blocksize required for registration with c8y
CONFIG_LWM2M_COAP_BLOCK_SIZE=1024
# Increase the number of observable resources to allow
# many sensors to be monitored by c8y.
CONFIG_LWM2M_ENGINE_MAX_OBSERVER=64

CONFIG_LWM2M_IPSO_SUPPORT=y
CONFIG_LWM2M_IPSO_TEMP_SENSOR=y
#CONFIG_LWM2M_IPSO_GENERIC_SENSOR=y
CONFIG_LWM2M_IPSO_HUMIDITY_SENSOR=y
CONFIG_LWM2M_IPSO_PRESSURE_SENSOR=y
CONFIG_LWM2M_IPSO_CURRENT_SENSOR=y
CONFIG_LWM2M_IPSO_FILLING_SENSOR=y
CONFIG_LWM2M_GATEWAY_OBJ_SUPPORT=y
CONFIG_LWM2M_CONN_MON_OBJ_SUPPORT=y
CONFIG_LWM2M_CONN_MON_BEARER_MAX=2
CONFIG_LWM2M_UCIFI_SUPPORT=y
CONFIG_LWM2M_UCIFI_BATTERY=y

# Support at least 3 BT610 sensors
# 1 BL654
# 1 MG100 temperature
# (10 BT510 [temperature only] or more BT610s)
#
# Each BT610 can have 4 temperature sensors
CONFIG_LWM2M_IPSO_TEMP_SENSOR_INSTANCE_COUNT=24
# Each BT610 can have a max of 2 pressure sensors
CONFIG_LWM2M_IPSO_PRESSURE_SENSOR_INSTANCE_COUNT=10
# Each BT610 can have 3 AC current sensors or 4 DC
CONFIG_LWM2M_IPSO_CURRENT_SENSOR_INSTANCE_COUNT=12
# Each BT610 can have one ultrasonic sensor
CONFIG_LWM2M_IPSO_FILLING_SENSOR_INSTANCE_COUNT=3

# Gateway object is used for reporting name and RSSI.
# Bridging functionality not implemented.
CONFIG_LWM2M_GATEWAY_MAX_INSTANCES=16
# Each sensor will have a battery level
CONFIG_LWM2M_UCIFI_BATTERY_INSTANCE_COUNT=16
CONFIG_LWM2M_GATEWAY_DEFAULT_IOT_DEVICE_OBJECTS=""

CONFIG_LCZ_LWM2M=y
CONFIG_LCZ_LWM2M_FW_UPDATE=y
CONFIG_LCZ_LWM2M_CONN_MON=y
CONFIG_LCZ_LWM2M_LOG_LEVEL=4
CONFIG_LCZ_LWM2M_SENSOR=y
CONFIG_LCZ_LWM2M_SENSOR_LOG_LEVEL=4
CONFIG_LCZ_LWM2M_SENSOR_ALLOW_BT510=y

CONFIG_LWM2M_DTLS_SUPPORT=y
CONFIG_LWM2M_PEER_PORT=5684

# Special MbedTLS changes
CONFIG_MBEDTLS_CIPHER_CCM_ENABLED=y
# Disable formats used by Californium (CoAP bridge) and AWS.
CONFIG_MBEDTLS_KEY_EXCHANGE_ECDHE_ECDSA_ENABLED=n
CONFIG_MBEDTLS_ECP_ALL_ENABLED=n
CONFIG_MBEDTLS_CIPHER_GCM_ENABLED=n
# Enable PSK instead
CONFIG_MBEDTLS_KEY_EXCHANGE_PSK_ENABLED=y

CONFIG_NET_SOCKETS_ENABLE_DTLS=y
```

## overlay_lwm2m_pinnacle_100.conf
```kconfig
# Unfortunately, LWM2M engine expects network to be up when it initializes.
# The gateway fsm adds a couple second tick delay.
CONFIG_MODEM_HL7800_BOOT_NORMAL=y
# Do not change the RAT at boot, leave it set to current config
CONFIG_MODEM_HL7800_RAT_NO_CHANGE=y

# The latency in NB-IoT can be 10 seconds.
# these values need to be greater than 10 seconds to account for the
# the latency of the connection after the cell tower.
CONFIG_NET_SOCKETS_CONNECT_TIMEOUT=13000
CONFIG_NET_SOCKETS_DTLS_TIMEOUT=15000
CONFIG_COAP_INIT_ACK_TIMEOUT_MS=15000
CONFIG_LWM2M_ENGINE_DEFAULT_LIFETIME=60
CONFIG_LWM2M_SECONDS_TO_UPDATE_EARLY=20
```

## overlay_memfault.conf
```kconfig
# Memfault
CONFIG_LCZ_MEMFAULT=y
CONFIG_LCZ_MEMFAULT_FILE=y
CONFIG_MEMFAULT_NRF_CONNECT_SDK=y
CONFIG_LCZ_MEMFAULT_HTTP_TRANSPORT=y
CONFIG_LCZ_MEMFAULT_MQTT_TRANSPORT=y
CONFIG_MEMFAULT_COREDUMP_MAX_TRACKED_TASKS=32
CONFIG_LCZ_MEMFAULT_METRICS=y
CONFIG_MEMFAULT_LOGGING_ENABLE=y
CONFIG_MEMFAULT_LOGGING_RAM_SIZE=2048
CONFIG_MEMFAULT_NCS_INTERNAL_FLASH_BACKED_COREDUMP=y
CONFIG_MEMFAULT_COREDUMP_COLLECT_BSS_REGIONS=y
CONFIG_PM_PARTITION_SIZE_MEMFAULT_STORAGE=0x8000
CONFIG_MBEDTLS_USER_CONFIG_ENABLE=y
CONFIG_MBEDTLS_USER_CONFIG_FILE="lcz-memfault-mbedtls.conf"
CONFIG_MEMFAULT_NCS_DEVICE_ID_RUNTIME=y
CONFIG_MEMFAULT_CLEAR_RESET_REG=n
CONFIG_MEMFAULT_NCS_FW_VERSION_STATIC=y
# Increase tx buffers with callback to support file upload
CONFIG_BT_CONN_TX_MAX=16
```

## boards/bl5340_dvk_cpuapp.conf
```kconfig
CONFIG_HEAP_MEM_POOL_SIZE=16384
CONFIG_BT_DEVICE_NAME="BL5340 OOB"
CONFIG_COAP_FOTA_PRODUCT="BL5340-DVK"

CONFIG_LCZ_NUMBER_OF_LEDS=4

CONFIG_SPI=y
CONFIG_NET_L2_ETHERNET=y
CONFIG_ETH_ENC424J600=y
CONFIG_NET_DHCPV4=y
CONFIG_NET_IF_MCAST_IPV4_ADDR_COUNT=0
CONFIG_NET_MGMT_EVENT_STACK_SIZE=1536
CONFIG_NET_MGMT_EVENT_QUEUE_SIZE=4

CONFIG_BOOTLOADER_MCUBOOT=y
CONFIG_UPDATEABLE_IMAGE_NUMBER=2
CONFIG_FLASH_NOP_DEVICE=y
CONFIG_PM_SINGLE_IMAGE=y

#CONFIG_BOOT_IMAGE_ACCESS_HOOKS=y
#CONFIG_BOOT_UPGRADE_ONLY=y

CONFIG_FW_INFO=y
CONFIG_I2C=y
CONFIG_SENSOR=y
CONFIG_LCZ_DRIVER=y

CONFIG_LCZ_MOTION=y

CONFIG_MG100_LIS2DH=y
CONFIG_MG100_LIS2DH_TRIGGER_OWN_THREAD=y
CONFIG_MG100_LIS2DH_ACCEL_RANGE_RUNTIME=y
CONFIG_MG100_LIS2DH_ODR_RUNTIME=y

CONFIG_GPIO_PCA953X=y

CONFIG_SNTP=y
CONFIG_DNS_RESOLVER_ADDITIONAL_BUF_CTR=1

# SDHC and FAT32 Support
CONFIG_DISK_ACCESS=y
CONFIG_DISK_DRIVER_SDMMC=y
CONFIG_SDMMC_OVER_SPI=y
CONFIG_SDMMC_VOLUME_NAME="SD"
CONFIG_FILE_SYSTEM=y
CONFIG_FAT_FILESYSTEM_ELM=y

# Stack sizes
CONFIG_MAIN_STACK_SIZE=8192
CONFIG_ISR_STACK_SIZE=4096
CONFIG_SYSTEM_WORKQUEUE_STACK_SIZE=12288
CONFIG_PRIVILEGED_STACK_SIZE=2048
CONFIG_KOBJECT_TEXT_AREA=1024

# Download client sizes
CONFIG_DOWNLOAD_CLIENT_BUF_SIZE=4096
CONFIG_DOWNLOAD_CLIENT_HTTP_FRAG_SIZE_4096=y
CONFIG_DOWNLOAD_CLIENT_STACK_SIZE=4096

# LCD display
CONFIG_DISPLAY=y
CONFIG_ILI9340=y
CONFIG_LVGL=y
CONFIG_LVGL_COLOR_DEPTH_16=y
CONFIG_LVGL_COLOR_16_SWAP=y
CONFIG_LVGL_BITS_PER_PIXEL=16
CONFIG_LVGL_USE_THEME_MATERIAL=y
CONFIG_LVGL_THEME_MATERIAL_DARK=y
CONFIG_LVGL_USE_OBJ_REALIGN=y
CONFIG_LVGL_USE_CONT=y
CONFIG_LVGL_USE_IMG=y
CONFIG_LVGL_USE_LABEL=y

# Bluetooth
CONFIG_BT_TINYCRYPT_ECC=y
CONFIG_BT_L2CAP_TX_BUF_COUNT=10
CONFIG_BT_L2CAP_TX_FRAG_COUNT=4

# Scan for 40 ms every 160 ms (25%)
# Default config doesn't work for BL5340
CONFIG_LCZ_BT_SCAN_DEFAULT_WINDOW=64
CONFIG_LCZ_BT_SCAN_DEFAULT_INTERVAL=256
```

## boards/bl5340_dvk_cpunet.conf
```kconfig
CONFIG_BT_MAX_CONN=3
CONFIG_BT_EXT_ADV=y
CONFIG_BT_EXT_ADV_LEGACY_SUPPORT=y
CONFIG_BT_EXT_ADV_MAX_ADV_SET=1
CONFIG_BT_HCI_CMD_COUNT=7
CONFIG_BT_RX_BUF_LEN=253
CONFIG_BT_DISCARDABLE_BUF_COUNT=7
CONFIG_BT_DISCARDABLE_BUF_SIZE=257
CONFIG_BT_CTLR_DUP_FILTER_LEN=8
CONFIG_BT_CTLR_RX_BUFFERS=7
CONFIG_BT_CTLR_TX_BUFFER_SIZE=251
CONFIG_BT_CTLR_LE_PING=n
CONFIG_BT_CTLR_DATA_LENGTH_MAX=251
```

## boards/bl5340pa_dvk_cpuapp.conf
```kconfig
CONFIG_HEAP_MEM_POOL_SIZE=16384
CONFIG_BT_DEVICE_NAME="BL5340PA OOB"
CONFIG_COAP_FOTA_PRODUCT="BL5340PA-DVK"

CONFIG_LCZ_NUMBER_OF_LEDS=4

CONFIG_SPI=y
CONFIG_NET_L2_ETHERNET=y
CONFIG_ETH_ENC424J600=y
CONFIG_NET_DHCPV4=y
CONFIG_NET_IF_MCAST_IPV4_ADDR_COUNT=0
CONFIG_NET_MGMT_EVENT_STACK_SIZE=1536
CONFIG_NET_MGMT_EVENT_QUEUE_SIZE=4

CONFIG_BOOTLOADER_MCUBOOT=y
CONFIG_PM_SINGLE_IMAGE=y

CONFIG_FW_INFO=y
CONFIG_I2C=y
CONFIG_SENSOR=y
CONFIG_LCZ=y
CONFIG_LCZ_DRIVER=y

CONFIG_LCZ_MOTION=y

CONFIG_MG100_LIS2DH=y
CONFIG_MG100_LIS2DH_TRIGGER_OWN_THREAD=y
CONFIG_MG100_LIS2DH_ACCEL_RANGE_RUNTIME=y
CONFIG_MG100_LIS2DH_ODR_RUNTIME=y

CONFIG_GPIO_PCA953X=y

CONFIG_SNTP=y
CONFIG_DNS_RESOLVER_ADDITIONAL_BUF_CTR=1

# SDHC and FAT32 Support
CONFIG_DISK_ACCESS=y
CONFIG_DISK_DRIVER_SDMMC=y
CONFIG_SDMMC_OVER_SPI=y
CONFIG_SDMMC_VOLUME_NAME="SD"
CONFIG_FILE_SYSTEM=y
CONFIG_FAT_FILESYSTEM_ELM=y

# Stack sizes
CONFIG_MAIN_STACK_SIZE=8192
CONFIG_ISR_STACK_SIZE=4096
CONFIG_SYSTEM_WORKQUEUE_STACK_SIZE=12288
CONFIG_PRIVILEGED_STACK_SIZE=2048
CONFIG_KOBJECT_TEXT_AREA=1024

# Download client sizes
CONFIG_DOWNLOAD_CLIENT_BUF_SIZE=4096
CONFIG_DOWNLOAD_CLIENT_HTTP_FRAG_SIZE_4096=y
CONFIG_DOWNLOAD_CLIENT_STACK_SIZE=4096

# LCD display
CONFIG_DISPLAY=y
CONFIG_ILI9340=y
CONFIG_LVGL=y
CONFIG_LVGL_COLOR_DEPTH_16=y
CONFIG_LVGL_COLOR_16_SWAP=y
CONFIG_LVGL_BITS_PER_PIXEL=16
CONFIG_LVGL_USE_THEME_MATERIAL=y
CONFIG_LVGL_THEME_MATERIAL_DARK=y
CONFIG_LVGL_USE_OBJ_REALIGN=y
CONFIG_LVGL_USE_CONT=y
CONFIG_LVGL_USE_IMG=y
CONFIG_LVGL_USE_LABEL=y

# Bluetooth
CONFIG_BT_TINYCRYPT_ECC=y
CONFIG_BT_L2CAP_TX_BUF_COUNT=10
CONFIG_BT_L2CAP_TX_FRAG_COUNT=4

# Scan for 40 ms every 160 ms (25%)
# Default config doesn't work for BL5340
CONFIG_LCZ_BT_SCAN_DEFAULT_WINDOW=64
CONFIG_LCZ_BT_SCAN_DEFAULT_INTERVAL=256

# RPMSG
CONFIG_LCZ_RPMSG=y
CONFIG_LCZ_RPMSG_MAX_MESSAGE_SIZE=16
CONFIG_RPMSG_SERVICE_NUM_ENDPOINTS=4

# Memfault
CONFIG_MEMFAULT_NCS_HW_VERSION="bl5340pa"
```

## boards/pinnacle_100.overlay
```dts
/* remove QSPI partitions from device tree because nRF Connect SDK 
 * partition manager will handle them.
 */
/delete-node/ &slot1_partition;
/delete-node/ &scratch_partition;
/delete-node/ &lfs_partition;
```

## boards/pinnacle_100_dvk.overlay
```dts
/* remove QSPI partitions from device tree because nRF Connect SDK
 * partition manager will handle them.
 */
/delete-node/ &slot1_partition;
/delete-node/ &scratch_partition;
/delete-node/ &lfs_partition;
```

## include/app_version.h
```c
/**
 * @file app_version.h
 * @brief
 *
 * Copyright (c) 2020 Laird Connectivity
 *
 * SPDX-License-Identifier: Apache-2.0
 */
#ifndef __APP_VERSION_H__
#define __APP_VERSION_H__

#ifdef __cplusplus
extern "C" {
#endif

/******************************************************************************/
/* Application Firmware Version                                               */
/******************************************************************************/
#define APP_VERSION_MAJOR 4
#define APP_VERSION_MINOR 1
#define APP_VERSION_PATCH 0
#define APP_VERSION_STRING                                                     \
	STRINGIFY(APP_VERSION_MAJOR)                                           \
	"." STRINGIFY(APP_VERSION_MINOR) "." STRINGIFY(APP_VERSION_PATCH)

#ifdef __cplusplus
}
#endif

#endif /* __APP_VERSION_H__ */
```

## include/aws.h
```c
/**
 * @file aws.h
 * @brief Amazon Web Services API
 *
 * Copyright (c) 2021 Laird Connectivity
 *
 * SPDX-License-Identifier: Apache-2.0
 */
#ifndef __AWS_H__
#define __AWS_H__

/******************************************************************************/
/* Includes                                                                   */
/******************************************************************************/
#include <data/json.h>
#include <net/mqtt.h>

#ifdef CONFIG_BOARD_MG100
#include "lairdconnect_battery.h"
#include "ble_motion_service.h"
#include "sdcard_log.h"
#endif

#ifdef __cplusplus
extern "C" {
#endif

/******************************************************************************/
/* Global Constants, Macros and Type Definitions                              */
/******************************************************************************/
/* AWS Root CA obtained from
*  https://docs.aws.amazon.com/iot/latest/developerguide/managing-device-certs.html
*/
static const unsigned char aws_root_ca[] =
	"-----BEGIN CERTIFICATE-----\n"
	"MIIDQTCCAimgAwIBAgITBmyfz5m/jAo54vB4ikPmljZbyjANBgkqhkiG9w0BAQsF\n"
	"ADA5MQswCQYDVQQGEwJVUzEPMA0GA1UEChMGQW1hem9uMRkwFwYDVQQDExBBbWF6\n"
	"b24gUm9vdCBDQSAxMB4XDTE1MDUyNjAwMDAwMFoXDTM4MDExNzAwMDAwMFowOTEL\n"
	"MAkGA1UEBhMCVVMxDzANBgNVBAoTBkFtYXpvbjEZMBcGA1UEAxMQQW1hem9uIFJv\n"
	"b3QgQ0EgMTCCASIwDQYJKoZIhvcNAQEBBQADggEPADCCAQoCggEBALJ4gHHKeNXj\n"
	"ca9HgFB0fW7Y14h29Jlo91ghYPl0hAEvrAIthtOgQ3pOsqTQNroBvo3bSMgHFzZM\n"
	"9O6II8c+6zf1tRn4SWiw3te5djgdYZ6k/oI2peVKVuRF4fn9tBb6dNqcmzU5L/qw\n"
	"IFAGbHrQgLKm+a/sRxmPUDgH3KKHOVj4utWp+UhnMJbulHheb4mjUcAwhmahRWa6\n"
	"VOujw5H5SNz/0egwLX0tdHA114gk957EWW67c4cX8jJGKLhD+rcdqsq08p8kDi1L\n"
	"93FcXmn/6pUCyziKrlA4b9v7LWIbxcceVOF34GfID5yHI9Y/QCB/IIDEgEw+OyQm\n"
	"jgSubJrIqg0CAwEAAaNCMEAwDwYDVR0TAQH/BAUwAwEB/zAOBgNVHQ8BAf8EBAMC\n"
	"AYYwHQYDVR0OBBYEFIQYzIU07LwMlJQuCFmcx7IQTgoIMA0GCSqGSIb3DQEBCwUA\n"
	"A4IBAQCY8jdaQZChGsV2USggNiMOruYou6r4lK5IpDB/G/wkjUu0yKGX9rbxenDI\n"
	"U5PMCCjjmCXPI6T53iHTfIUJrU6adTrCC2qJeHZERxhlbI1Bjjt/msv0tadQ1wUs\n"
	"N+gDS63pYaACbvXy8MWy7Vu33PqUXHeeE6V/Uq2V8viTO96LXFvKWlJbYK8U90vv\n"
	"o/ufQJVtMVT8QtPHRh8jrdkPSHCa2XV4cdFyQzR1bldZwgJcJmApzyMZFo6IQ6XU\n"
	"5MsI+yMRQ+hDKXJioaldXgjUkK642M4UwtBV8ob2xJNDd2ZhwLnoQdeXeGADbkpy\n"
	"rqXRfboQnoZsG4q5WTP468SQvvG5\n"
	"-----END CERTIFICATE-----\n";

#define AWS_DEFAULT_ENDPOINT "a3273rvo818l4w-ats.iot.us-east-1.amazonaws.com"

#define SERVER_PORT_STR "8883"

#define APP_SLEEP_MSECS 500
#define SOCKET_POLL_WAIT_TIME_MSECS 250

#define APP_CONNECT_TRIES 1

#ifdef CONFIG_BOARD_MG100
#define DEFAULT_MQTT_CLIENTID "mg100"
#else
#define DEFAULT_MQTT_CLIENTID "pinnacle100_oob"
#endif
#define AWS_MQTT_ID_MAX_SIZE 128

#define SHADOW_STATE_NULL "{\"state\":null}"
#define SHADOW_REPORTED_START "{\"state\":{\"reported\":{"
#define SHADOW_REPORTED_END "}}}"

#define SHADOW_TEMPERATURE "\"temperature\":"
#define SHADOW_HUMIDITY "\"humidity\":"
#define SHADOW_PRESSURE "\"pressure\":"
#ifdef CONFIG_MODEM_HL7800
#define SHADOW_RADIO_RSSI "\"radio_rssi\":"
#define SHADOW_RADIO_SINR "\"radio_sinr\":"
#endif /* CONFIG_MODEM_HL7800 */
#ifdef CONFIG_BOARD_MG100
#define SHADOW_MG100_TEMP "\"tempC\":"
#define SHADOW_MG100_BATT_LEVEL "\"batteryLevel\":"
#define SHADOW_MG100_BATT_VOLT "\"batteryVoltageMv\":"
#define SHADOW_MG100_PWR_STATE "\"powerState\":"
#define SHADOW_MG100_BATT_LOW "\"batteryLowThreshold\":"
#define SHADOW_MG100_BATT_0 "\"battery0\":"
#define SHADOW_MG100_BATT_1 "\"battery1\":"
#define SHADOW_MG100_BATT_2 "\"battery2\":"
#define SHADOW_MG100_BATT_3 "\"battery3\":"
#define SHADOW_MG100_BATT_4 "\"battery4\":"
#define SHADOW_MG100_BATT_GOOD "\"batteryGood\":"
#define SHADOW_MG100_BATT_BAD "\"batteryBadThreshold\":"
#define SHADOW_MG100_ODR "\"odr\":"
#define SHADOW_MG100_SCALE "\"scale\":"
#define SHADOW_MG100_ACT_THS "\"activationThreshold\":"
#define SHADOW_MG100_MOVEMENT "\"movement\":"
#define SHADOW_MG100_MAX_LOG_SIZE "\"maxLogSizeMB\":"
#define SHADOW_MG100_SDCARD_FREE "\"sdCardFreeMB\":"
#define SHADOW_MG100_CURR_LOG_SIZE "\"logSizeMB\":"
#endif /* CONFIG_BOARD_MG100 */

#define AWS_RX_THREAD_STACK_SIZE 2048
#define AWS_RX_THREAD_PRIORITY K_PRIO_COOP(15)

#define GATEWAY_TOPIC NULL

struct shadow_persistent_values {
	const char *firmware_version;
	const char *os_version;
#ifdef CONFIG_MODEM_HL7800
	const char *radio_version;
	const char *IMEI;
	const char *ICCID;
	const char *radio_sn;
#endif /* CONFIG_MODEM_HL7800 */
	bool codedPhySupported;
	bool httpFotaEnabled;
};

struct shadow_state_reported {
	struct shadow_persistent_values reported;
};

struct shadow_reported_struct {
	struct shadow_state_reported state;
};

static const struct json_obj_descr shadow_persistent_values_descr[] = {
	JSON_OBJ_DESCR_PRIM(struct shadow_persistent_values, firmware_version,
			    JSON_TOK_STRING),
	JSON_OBJ_DESCR_PRIM(struct shadow_persistent_values, os_version,
			    JSON_TOK_STRING),
#ifdef CONFIG_MODEM_HL7800
	JSON_OBJ_DESCR_PRIM(struct shadow_persistent_values, radio_version,
			    JSON_TOK_STRING),
	JSON_OBJ_DESCR_PRIM(struct shadow_persistent_values, IMEI,
			    JSON_TOK_STRING),
	JSON_OBJ_DESCR_PRIM(struct shadow_persistent_values, ICCID,
			    JSON_TOK_STRING),
	JSON_OBJ_DESCR_PRIM(struct shadow_persistent_values, radio_sn,
			    JSON_TOK_STRING),
#endif /* CONFIG_MODEM_HL7800 */
	JSON_OBJ_DESCR_PRIM(struct shadow_persistent_values, codedPhySupported,
			    JSON_TOK_TRUE),
	JSON_OBJ_DESCR_PRIM(struct shadow_persistent_values, httpFotaEnabled,
			    JSON_TOK_TRUE),
};

static const struct json_obj_descr shadow_state_reported_descr[] = {
	JSON_OBJ_DESCR_OBJECT(struct shadow_state_reported, reported,
			      shadow_persistent_values_descr),
};

static const struct json_obj_descr shadow_descr[] = {
	JSON_OBJ_DESCR_OBJECT(struct shadow_reported_struct, state,
			      shadow_state_reported_descr),
};

/******************************************************************************/
/* Global Function Prototypes                                                 */
/******************************************************************************/
int awsInit(void);
int awsSetCredentials(const uint8_t *cert, const uint8_t *key);
void awsSetRootCa(const char *cred);
void awsSetEndpoint(const char *ep);
void awsSetClientId(const char *id);
int awsGetServerAddr(void);
int awsConnect(void);
bool awsConnected(void);
bool awsPublished(void);
void awsDisconnect(void);
int awsSendData(char *data, uint8_t *topic);
int awsSendBinData(char *data, uint32_t len, uint8_t *topic);
int awsPublishShadowPersistentData(void);
int awsSetShadowKernelVersion(const char *version);
#ifdef CONFIG_MODEM_HL7800
int awsSetShadowIMEI(const char *imei);
int awsSetShadowICCID(const char *iccid);
int awsSetShadowRadioSerialNumber(const char *sn);
int awsSetShadowRadioFirmwareVersion(const char *version);
#endif /* CONFIG_MODEM_HL7800 */
int awsSetShadowAppFirmwareVersion(const char *version);
int awsPublishBl654SensorData(float temperature, float humidity,
			      float pressure);
#if defined(CONFIG_BOARD_MG100)
int awsPublishPinnacleData(int radioRssi, int radioSinr,
			   struct battery_data *battery,
			   struct motion_status *motion,
			   struct sdcard_status *sdcard);
#elif defined(CONFIG_BOARD_PINNACLE_100_DVK)
int awsPublishPinnacleData(int radioRssi, int radioSinr);
#endif
int awsSubscribe(uint8_t *topic, uint8_t subscribe);
int awsGetShadow(void);
int awsGetAcceptedSubscribe(void);
int awsGetAcceptedUnsub(void);
void awsGenerateGatewayTopics(const char *deviceid);
void awsDisconnectCallback(void);
char *awsGetGatewayUpdateDeltaTopic(void);
struct mqtt_client *awsGetMqttClient(void);

#ifdef __cplusplus
}
#endif

#endif /* __AWS_H__ */
```

## include/ble.h
```c
/**
 * @file ble.h
 * @brief This module enables Bluetooth during system initialization.
 *
 * Copyright (c) 2020 Laird Connectivity
 *
 * SPDX-License-Identifier: Apache-2.0
 */
#ifndef __BLE_H__
#define __BLE_H__

#ifdef __cplusplus
extern "C" {
#endif

/******************************************************************************/
/* Global Function Prototypes                                                 */
/******************************************************************************/
/**
 * @brief Update Bluetooth device name.  This name is used in advertisements.
 *
 * @param imei from SIM card.
 *
 */
void ble_update_name(const char *imei);

#ifdef __cplusplus
}
#endif

#endif /* __BLE_H__ */
```

## include/ble_aws_service.h
```c
/**
 * @file ble_aws_service.h
 * @brief
 *
 * Copyright (c) 2021 Laird Connectivity
 *
 * SPDX-License-Identifier: Apache-2.0
 */
#ifndef __BLE_AWS_SERVICE_H__
#define __BLE_AWS_SERVICE_H__

#ifdef __cplusplus
extern "C" {
#endif

/******************************************************************************/
/* Incluces                                                                   */
/******************************************************************************/
#include <bluetooth/uuid.h>
#include <bluetooth/gatt.h>

/******************************************************************************/
/* Global Constants, Macros and Type Definitions                              */
/******************************************************************************/
/* clang-format off */
#define AWS_CLIENT_ID_MAX_LENGTH     CONFIG_APP_AWS_CLIENT_ID_MAX_LENGTH
#define AWS_ENDPOINT_MAX_LENGTH      CONFIG_APP_AWS_ENDPOINT_MAX_LENGTH
#define AWS_ROOT_CA_MAX_LENGTH       CONFIG_APP_AWS_MAX_CREDENTIAL_SIZE
#define AWS_CLIENT_CERT_MAX_LENGTH   CONFIG_APP_AWS_MAX_CREDENTIAL_SIZE
#define AWS_CLIENT_KEY_MAX_LENGTH    CONFIG_APP_AWS_MAX_CREDENTIAL_SIZE
#define AWS_CREDENTIAL_HEADER_SIZE   4
#define AWS_TOPIC_PREFIX_MAX_LENGTH  256
/* clang-format on */

enum aws_status {
	AWS_STATUS_NOT_PROVISIONED = 0,
	AWS_STATUS_DISCONNECTED,
	AWS_STATUS_CONNECTED,
	AWS_STATUS_CONNECTION_ERR,
	AWS_STATUS_CONNECTING
};

enum aws_svc_err {
	AWS_SVC_ERR_NONE = 0,
	AWS_SVC_ERR_INIT_ENDPOINT = -1,
	AWS_SVC_ERR_INIT_CLIENT_ID = -2,
	AWS_SVC_ERR_INIT_ROOT_CA = -3,
	AWS_SVC_ERR_READ_CRED_FS = -4,
	AWS_SVC_ERR_CRED_SIZE = -5,
	AWS_SVC_ERR_INIT_TOPIC_PREFIX = -6
};

enum aws_svc_event {
	AWS_SVC_EVENT_SETTINGS_SAVED,
	AWS_SVC_EVENT_SETTINGS_CLEARED,
};

/******************************************************************************/
/* Global Function Prototypes                                                 */
/******************************************************************************/
/**
 * @brief Callback function prototype for AWS service events
 */
typedef void (*aws_svc_event_function_t)(enum aws_svc_event event);

int aws_svc_init(const char *clientId);
void aws_svc_set_client_id(const char *id);
void aws_svc_set_endpoint(const char *ep);
void aws_svc_set_status(enum aws_status status);
void aws_svc_set_root_ca(const char *cred);
void aws_svc_set_client_cert(const char *cred);
void aws_svc_set_client_key(const char *cred);
void aws_svc_set_topic_prefix(const char *prefix);
const char *aws_svc_get_topic_prefix(void);
bool aws_svc_client_cert_is_stored(void);
bool aws_svc_client_key_is_stored(void);
const char *aws_svc_get_client_cert(void);
const char *aws_svc_get_client_key(void);
int aws_svc_save_clear_settings(bool save);

void aws_svc_set_root_ca_partial(const char *cred, int offset, int len);
void aws_svc_set_client_cert_partial(const char *cred, int offset, int len);
void aws_svc_set_client_key_partial(const char *cred, int offset, int len);

/* Override weak implementation in app */
void awsSvcEvent(enum aws_svc_event event);

#ifdef __cplusplus
}
#endif

#endif /* __BLE_AWS_SERVICE_H__ */
```

## include/ble_motion_service.h
```c
/**
 * @file ble_motion_service.h
 * @brief Allows the a notification to be sent on movement of the device.
 *
 * Copyright (c) 2020 Laird Connectivity
 *
 * SPDX-License-Identifier: Apache-2.0
 */
#ifndef __BLE_MOTION_SERVICE_H__
#define __BLE_MOTION_SERVICE_H__

/******************************************************************************/
/* Includes                                                                   */
/******************************************************************************/
#include <bluetooth/conn.h>
#include <zephyr/types.h>

#ifdef __cplusplus
extern "C" {
#endif

/******************************************************************************/
/* Global Constants, Macros and Type Definitions                              */
/******************************************************************************/
#define MOTION_DEFAULT_THS		10
#define MOTION_DEFAULT_ODR		5
#define MOTION_DEFAULT_SCALE	2
#define MOTION_DEFAULT_DUR		6

/******************************************************************************/
/* Global Function Definitions                                                */
/******************************************************************************/
struct motion_status {
	int scale;
	int odr;
	int thr;
	uint8_t motion;
};
/**
 * @brief this function retrieves the latest motion status
 *
 * @param none
 *
 * @retval motion status structure.
 */
struct motion_status *motionGetStatus();

/**
 * @brief this function is called by the gateway JSON parser to set a parameter
 *  in the accelerometer.
 *
 * @param int Value - the value
 *
 * @retval none
 */
bool UpdateOdr(int Value);

/**
 * @brief this function is called by the gateway JSON parser to set a parameter
 *  in the accelerometer.
 *
 * @param int Value - the value
 *
 * @retval none
 */
bool UpdateScale(int Value);

/**
 * @brief this function is called by the gateway JSON parser to set a parameter
 *  in the accelerometer.
 *
 * @param int Value - the value
 *
 * @retval none
 */
bool UpdateActivityThreshold(int Value);

/**
 * @brief this function is called by the gateway JSON parser to get a parameter
 *  in the accelerometer.
 *
 * @param int * Value - the value read from NVS
 *
 * @retval none
 */
int GetOdr();

/**
 * @brief this function is called by the gateway JSON parser to get a parameter
 *  in the accelerometer.
 *
 * @param int * Value - the value read from NVS
 *
 * @retval none
 */
int GetScale();

/**
 * @brief this function is called by the gateway JSON parser to get a parameter
 *  in the accelerometer.
 *
 * @param int * Value - the value read from NVS
 *
 * @retval none
 */
int GetActivityThreshold();

void motion_svc_init();
void motion_svc_set_alarm_state(uint8_t alarmState);

#ifdef __cplusplus
}
#endif

#endif /* __BLE_MOTION_SERVICE_H__ */
```

## include/ble_sensor_service.h
```c
/**
 * @file ble_sensor_service.h
 * @brief
 *
 * Copyright (c) 2021 Laird Connectivity
 *
 * SPDX-License-Identifier: Apache-2.0
 */
#ifndef __BLE_SENSOR_SERVICE_H__
#define __BLE_SENSOR_SERVICE_H__

/******************************************************************************/
/* Includes                                                                   */
/******************************************************************************/
#include <bluetooth/conn.h>
#include <zephyr/types.h>

#include "sensor_state.h"

#ifdef __cplusplus
extern "C" {
#endif

/******************************************************************************/
/* Global Function Prototypes                                                 */
/******************************************************************************/
/* For multi-peripheral device the weak implementation can be overriden. */
struct bt_conn *bss_get_conn(void);

void bss_set_sensor_state(enum sensor_state state);

/**
 * @param addr If NULL then sensor bt addr string is cleared.
 */
void bss_set_sensor_bt_addr(char *addr);

/**
 * @brief Initialize the sensor service
 */
void bss_init();

#ifdef __cplusplus
}
#endif

#endif /* __BLE_SENSOR_SERVICE_H__ */
```

## include/button.h
```c
/**
 * @file button.h
 * @brief
 *
 * Copyright (c) 2021 Laird Connectivity
 *
 * SPDX-License-Identifier: Apache-2.0
 */
#ifndef __BUTTON_H__
#define __BUTTON_H__

#ifdef __cplusplus
extern "C" {
#endif

/******************************************************************************/
/* Includes                                                                   */
/******************************************************************************/
#include <zephyr/types.h>
#include <stddef.h>

/******************************************************************************/
/* Global Constants, Macros and Type Definitions                              */
/******************************************************************************/
typedef struct button_config {
	/* Durations in milliseconds.  When 0 value isn't used. */
	int64_t min_hold;
	int64_t max_hold;
	int (*callback)(void);
} button_config_t;

/******************************************************************************/
/* Global Function Prototypes                                                 */
/******************************************************************************/
/**
 * @brief Assign callbacks that occur on release of the button.
 *
 * @note Callbacks occur in ISR context.
 *
 * @param config is a button configuration structure
 * @param count is the number of configurations
 * @param on_press_callback is called when button is pressed
 *
 * @retval 0 on success, negative error code otherwise.
 */
int button_initialize(const button_config_t *const config, size_t count,
		      int (*on_press_callback)(void));

#ifdef __cplusplus
}
#endif

#endif /* __BUTTON_H__ */
```

## include/led_configuration.h
```c
/**
 * @file led_configuration.h
 * @brief
 *
 * Copyright (c) 2020-2021 Laird Connectivity
 *
 * SPDX-License-Identifier: Apache-2.0
 */
#ifndef __LED_CONFIGURATION_H__
#define __LED_CONFIGURATION_H__

/******************************************************************************/
/* Includes                                                                   */
/******************************************************************************/
#include "lcz_led.h"

#ifdef __cplusplus
extern "C" {
#endif

/******************************************************************************/
/* Board definitions                                                          */
/******************************************************************************/

#if defined(CONFIG_BOARD_MG100) || defined(CONFIG_BOARD_PINNACLE_100_DVK)
/* Pinnacle 100 DVK or MG100 */
#define LED1_NODE DT_ALIAS(led0)
#define LED2_NODE DT_ALIAS(led1)
#define LED3_NODE DT_ALIAS(led2)
#ifdef CONFIG_BOARD_PINNACLE_100_DVK
#define LED4_NODE DT_ALIAS(led3)
#endif

#define LED1_DEV DT_GPIO_LABEL(LED1_NODE, gpios)
#define LED1 DT_GPIO_PIN(LED1_NODE, gpios)
#define LED2_DEV DT_GPIO_LABEL(LED2_NODE, gpios)
#define LED2 DT_GPIO_PIN(LED2_NODE, gpios)
#define LED3_DEV DT_GPIO_LABEL(LED3_NODE, gpios)
#define LED3 DT_GPIO_PIN(LED3_NODE, gpios)
#ifdef CONFIG_BOARD_PINNACLE_100_DVK
#define LED4_DEV DT_GPIO_LABEL(LED4_NODE, gpios)
#define LED4 DT_GPIO_PIN(LED4_NODE, gpios)
#endif

enum led_index {
	BLUE_LED = 0,
	GREEN_LED,
	RED_LED,
#ifdef CONFIG_BOARD_PINNACLE_100_DVK
	GREEN_LED2
#endif
};

enum led_type_index {
	BLUETOOTH_LED = BLUE_LED,
	NETWORK_LED = RED_LED,
	CLOUD_LED = GREEN_LED
};

#ifdef CONFIG_BOARD_PINNACLE_100_DVK
BUILD_ASSERT(CONFIG_LCZ_NUMBER_OF_LEDS > GREEN_LED2, "LED object too small");
#else
BUILD_ASSERT(CONFIG_LCZ_NUMBER_OF_LEDS > RED_LED, "LED object too small");
#endif
#else
#error "Unsupported board selected"
#endif

#ifdef __cplusplus
}
#endif

#endif /* __LED_CONFIGURATION_H__ */
```
