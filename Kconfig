## app/common/Kconfig.http_file_download
```kconfig
# Copyright (c) 2022 Laird Connectivity
# SPDX-License-Identifier: Apache-2.0

config HTTP_FILE_DOWNLOAD
    bool "Enable file download over HTTP"
    select FILE_SYSTEM_UTILITIES
    select DOWNLOAD_CLIENT

module=HTTP_FILE_DOWNLOAD
module-dep=LOG
module-str=HTTP_FILE_DOWNLOAD
source "${ZEPHYR_BASE}/subsys/logging/Kconfig.template.log_config"

if HTTP_FILE_DOWNLOAD

config HFD_SOCKET_RETRIES
	int "Number of retries for socket-related download issues"
	default 2

config HFD_DEVICE_LIST_MAX_STR_SIZE
    int "Maximum size (with terminator) of device list string"
    default 192

endif # HTTP_FILE_DOWNLOAD
```

## app/common/Kconfig.jsmn
```kconfig
# Copyright (c) 2021-2023 Laird Connectivity
# SPDX-License-Identifier: Apache-2.0

menuconfig JSMN
    bool "Enable JSMN module wrapper"

if JSMN

config JSMN_NUMBER_OF_TOKENS
    int "The number of tokens for jsmn"
    default 512
    help
        JSMN is used to process shadow and CoAP messages.
        The maximum size of the shadow (and tokens required) is affected
        by the number of sensors and the sensor log size.
        The timestamps that are generated by AWS make the shadow large.

module=JSMN
module-dep=LOG
module-str=JSMN
source "${ZEPHYR_BASE}/subsys/logging/Kconfig.template.log_config"

endif # JSMN
```

## app/common/Kconfig.lcz_certs
```kconfig
# Copyright (c) 2022 Laird Connectivity
# SPDX-License-Identifier: Apache-2.0

menuconfig LCZ_CERTS
    bool "Config Certificate Module"

if LCZ_CERTS

config LCZ_CERTS_CA_CERT_TAG
    int "mbedTLS tag for CA"
    default 1

config LCZ_CERTS_DEVICE_CERT_TAG
    int "mbedTLS tag for device cert and private key"
    default 2
    help
      Set to 0 to disable

config LCZ_CERTS_PSK
    bool "Use private shared key instead of device cert"

module=LCZ_CERTS
module-dep=LOG
module-str=LCZ_CERTS
source "${ZEPHYR_BASE}/subsys/logging/Kconfig.template.log_config"

endif # LCZ_CERTS
```

## app/common/Kconfig.lcz_motion
```kconfig
# Copyright (c) 2021 Laird Connectivity
# SPDX-License-Identifier: Apache-2.0

config LCZ_MOTION
    bool "Enable motion driver"
    depends on (BOARD_MG100 || BOARD_BL5340_DVK_CPUAPP)

config LCZ_MOTION_LOG_LEVEL
    int "Motion driver log level"
    depends on LCZ_MOTION
    range 0 4
    default 3
```

## app/common/Kconfig.lcz_motion_temperature
```kconfig
# Copyright (c) 2021 Laird Connectivity
# SPDX-License-Identifier: Apache-2.0

config LCZ_MOTION_TEMPERATURE
    bool "Enable reading temperature from accelerometer"
    depends on (BOARD_MG100 || BOARD_BL5340_DVK_CPUAPP)
    depends on LIS2DH_MEASURE_TEMPERATURE

if LCZ_MOTION_TEMPERATURE

config LCZ_MOTION_TEMPERATURE_LOG_LEVEL
    int "Temperature from accelerometer driver log level"
    range 0 4
    default 3

config LCZ_MOTION_TEMPERATURE_SAMPLE_RATE_SECONDS
    int "Temperature sample rate"
    default 30

config LCZ_MOTION_TEMPERATURE_INIT_PRIORITY
    int "Application init priority"
    default 99

endif
```

## app/common/Kconfig.lcz_mqtt
```kconfig
# Copyright (c) 2021-2022 Laird Connectivity
# SPDX-License-Identifier: Apache-2.0

menuconfig LCZ_MQTT
    bool "Config LCZ_MQTT Module"
    select SHADOW_PARSER
    select LCZ_CERTS

if LCZ_MQTT

config LCZ_MQTT_RX_BUFFER_SIZE
    int "Size of buffer for MQTT rx path"
    default 1024

config LCZ_MQTT_TX_BUFFER_SIZE
    int "Size of buffer for MQTT tx path"
    default 1536

config LCZ_MQTT_PUBLISH_WATCHDOG_SECONDS
    int "Watchdog timeout for successful MQTT publish"
    default 3600
    help
        Disabled when 0
        Not enabled until first successful publish
        Timeout causes a reset
        Shouldn't be enabled if periodic data isn't sent.

config LCZ_MQTT_CONNECT_TRIES
    int "Number of times to try to connect to LCZ_MQTT before reporting a failure"
    default 1

config LCZ_MQTT_MAX_CONSECUTIVE_CONNECTION_FAILURES
    int "Maximum consecutive connection failures before reset"
    default 0
    help
        Disabled when 0

config LCZ_MQTT_SHADOW_IN_MAX_SIZE
    int "Maximum size of subscription/shadow that can be processed"
    default 8192
    help
        The timestamps can make the shadow larger than 7K bytes.

config LCZ_MQTT_SHADOW_TOPIC_MAX_SIZE
    int "Maximum size of topic"
    default 128

module=LCZ_MQTT
module-dep=LOG
module-str=LCZ_MQTT
source "${ZEPHYR_BASE}/subsys/logging/Kconfig.template.log_config"

if LCZ_MQTT_LOG_LEVEL >= 3

config LCZ_MQTT_LOG_MQTT_PUBLISH
    bool "Print data published to LCZ_MQTT"

config LCZ_MQTT_LOG_MQTT_PUBLISH_TOPIC
    bool "Print the topic that docs are published"

config LCZ_MQTT_LOG_MQTT_SUBSCRIPTION
    bool "Enable/Disable printing of received MQTT data"

config LCZ_MQTT_LOG_MQTT_SUBSCRIPTION_TOPIC
    bool "Enable/Disable printing of received MQTT topic"

endif # LOG_LEVEL

config LCZ_MQTT_KEEPALIVE_VERBOSE
    bool "Log status for keep alive"
    depends on LCZ_MQTT_LOG_LEVEL >= LCZ_MQTT_LOG_LEVEL_INF

endif # LCZ_MQTT
```

## app/common/Kconfig.lte
```kconfig
# Copyright (c) 2021 Laird Connectivity
# SPDX-License-Identifier: Apache-2.0

menuconfig LTE
    bool "Enable LTE module"
    default y if MODEM_HL7800
    help
      An application layer driver for the HL7800.

if LTE

module=LTE
module-dep=LOG
module-str=LTE
source "${ZEPHYR_BASE}/subsys/logging/Kconfig.template.log_config"

config LTE_UPDATE_QRTC_LAST_SET
    bool "Update qrtc last set attribute when time received from modem"
    help
      If qrtc last set is savable,
      then the file system will be written.

config LTE_INIT_PRIORITY
	int "LTE Init Priority"
	default 70
	help
    Note that the priority needs to be lower than the HL7800 and
    net stack so that it can start before the networking sub-system.

endif # LTE
```

## app/common/Kconfig.shadow_parser
```kconfig
# Copyright (c) 2021 Laird Connectivity
# SPDX-License-Identifier: Apache-2.0

menuconfig SHADOW_PARSER
    bool "Enable Shadow Parser Module"
    help
        This depends on jsmn

if SHADOW_PARSER

module=SHADOW_PARSER
module-dep=LOG
module-str=SHADOW_PARSER
source "${ZEPHYR_BASE}/subsys/logging/Kconfig.template.log_config"

config SHADOW_PARSER_FLAGS_AWS
    bool "Match topic strings used for AWS"

endif # SHADOW_PARSER
```

## app/common/Kconfig.single_peripheral
```kconfig
# Copyright (c) 2021 Laird Connectivity
# SPDX-License-Identifier: Apache-2.0

menuconfig SINGLE_PERIPHERAL
    bool "Enable single peripheral (one connection at a time) module"
    help
        Handles advertising
        Prints connection information

if SINGLE_PERIPHERAL

config SINGLE_PERIPHERAL_INIT_PRIORITY
    int "Priority of module init (Application)"
    range 1 99
    default 30
    help
        Must be initialized after Bluetooth is enabled

config SINGLE_PERIPHERAL_LOG_LEVEL
    int "Log level for single peripheral module"
    range 0 4
    default 3

config SINGLE_PERIPHERAL_ADV_ON_INIT
    bool "Start advertising after initialization"
    help
        Advertising after reset is used by the
        mobile application when updating firmware.

config SINGLE_PERIPHERAL_ADV_DURATION_SECONDS
    int "Seconds to advertise, 0 is indefinite"
    default 30
    help
        This value is also used to restart advertising after a disconnect.

config SINGLE_PERIPHERAL_PAIR
    bool "Enable security callbacks and security timeout"
    default y if MCUMGR_SMP_BT_AUTHEN
    help
        The callbacks are configured for Just Works.
        If MCUMGR_SMP_BT_AUTHEN is enabled, then callbacks must be
        added because Just Works isn't authenticated.

endif # SINGLE_PERIPHERAL
```
